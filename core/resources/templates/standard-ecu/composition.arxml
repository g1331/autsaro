AUTOSAR XML (schema 00053)
package /Application
  composition sw component type ReferenceComposition
    component EchoApplicationInstance: type=EchoApplication
    component DcmService: type=DcmService
    component ComMService: type=ComMService
    connect EchoApplicationInstance.ApplicationValue -> DcmService.DataServices_ApplicationValue
