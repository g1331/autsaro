AUTOSAR XML (schema 00053)
package /Application
  composition sw component type ReferenceComposition
    component EchoApplicationInstance: type=EchoApplication
    component DcmService: type=DcmService
    connect EchoApplicationInstance.ApplicationValue -> DcmService.DataServices_ApplicationValue
