AUTOSAR XML (schema 00053)
package /Configuration
  sw addr method CODE: section-type=CODE
  module config Os: ecuc-def-edition=4.10.0, implementation-config-variant=VARIANT-PRE-COMPILE, post-build-variant-used=false
    OSDEFAULTAPPMODE (OsAppMode)
    OperatingSystem (OsOS):
      OsStatus = EXTENDED
      OsScalabilityClass = SC1
      OsUseResScheduler = false
      OsUseGetServiceId = true
      OsUseParameterAccess = true
      OsLockTrustedFunctionCall = true
      OsStackMonitoring = true
      OsUseArti = true
      Hooks (OsHooks): OsStartupHook=true, OsShutdownHook=true, OsErrorHook=true, OsPreTaskHook=true, OsPostTaskHook=true, OsProtectionHook=false
    Task_Ecu (OsTask):
      OsTaskActivation = 1
      OsTaskPriority = 1
      OsTaskSchedule = FULL
      OsMemoryMappingCodeLocationRef = CODE
      OsTaskEventRef = Ev_Work
      OsTaskEventRef = Ev_App
      OsTaskEventRef = Ev_IO
      Autostart (OsTaskAutostart): OsTaskAppModeRef=OSDEFAULTAPPMODE
    3 x OsEvent:
      Ev_Work: OsEventMask=1
      Ev_App: OsEventMask=2
      Ev_IO: OsEventMask=4
    SystemCounter (OsCounter): OsCounterMaxAllowedValue=65535, OsCounterMinCycle=1, OsCounterTicksPerBase=1, OsCounterType=SOFTWARE, OsSecondsPerTick=0.001
    Alarm_Work (OsAlarm): OsAlarmCounterRef=SystemCounter
      Autostart (OsAlarmAutostart): OsAlarmAlarmTime=1, OsAlarmCycleTime=1, OsAlarmAutostartType=RELATIVE, OsAlarmAppModeRef=OSDEFAULTAPPMODE
      Action (OsAlarmAction)
        SetEvent (OsAlarmSetEvent): OsAlarmSetEventTaskRef=Task_Ecu, OsAlarmSetEventRef=Ev_Work
    Alarm_App (OsAlarm): OsAlarmCounterRef=SystemCounter
      Autostart (OsAlarmAutostart): OsAlarmAlarmTime=10, OsAlarmCycleTime=10, OsAlarmAutostartType=RELATIVE, OsAlarmAppModeRef=OSDEFAULTAPPMODE
      Action (OsAlarmAction)
        SetEvent (OsAlarmSetEvent): OsAlarmSetEventTaskRef=Task_Ecu, OsAlarmSetEventRef=Ev_App
  module config Rte: ecuc-def-edition=4.10.0, implementation-config-variant=VARIANT-PRE-COMPILE, post-build-variant-used=false
    Generation (RteGeneration):
      RteDevErrorDetect = false
      RteDevErrorDetectUninit = false
      RteInExclusiveAreaCheckEnabled = false
      RteMeasurementSupport = false
      RteValueRangeCheckEnabled = false
      RteVfbTraceAnonymousClientEnabled = false
      RteVfbTraceEnabled = false
      RteCodeVendorId = 0
      RteBypassSupport = NONE
      RteCalibrationSupport = NONE
      RteGenerationMode = COMPATIBILITY_MODE
      RteOptimizationMode = RUNTIME
    BswGeneral (RteBswGeneral): RteSchMVersionInfoApi=false
    InitializeINIT (RteInitializationBehavior): RteInitializationStrategy=RTE_INITIALIZATION_STRATEGY_AT_DATA_DECLARATION, RteSectionInitializationPolicy=INIT
    InitializeCLEARED (RteInitializationBehavior): RteInitializationStrategy=RTE_INITIALIZATION_STRATEGY_NONE, RteSectionInitializationPolicy=CLEARED
    ComUser (RteComUser): RteComUserEcucPartitionRef=OwnerPartition
      Callbacks (ComUserModuleCnf): ComUserHeaderInclude=Rte_Com.h
        Reception (ComUserCallback): ComUserCallbackName=Rte_COMCbk, ComUserCallbackType=COM_RX_ACK
        Timeout (ComUserCallback): ComUserCallbackName=Rte_COMCbkRxTOut, ComUserCallbackType=COM_RX_TOUT
        RxValue (ComUserSignal): ComUserCbkHandleId=17, ComUserSystemTemplateSystemSignalRef=RxValueMap, ComUserCallbackRef=Reception, ComUserCallbackRef=Timeout
    Ingress (RteSwComponentInstance): RteSoftwareComponentInstanceRef=IngressInstance
      Periodic10ms (RteEventToTaskMapping):
        RteEventIsMappedToTask = true
        RtePositionInTask = 4
        RteEventRef = Periodic10ms
        RteMappedToTaskRef = Task_Ecu
        RteUsedOsAlarmRef = Alarm_App
        RteUsedOsEventRef = Ev_App
      ReadApplicationValue (RteEventToTaskMapping): RteEventIsMappedToTask=false, RteEventRef=InvokeReadData
    4 x RteBswModuleInstance:
      Can: RteBswImplementationRef=Can_Implementation
        5 x RteBswEventToTaskMapping, all with RteBswEventIsMappedToTask=true, RteBswMappedToTaskRef=Task_Ecu, RteBswUsedOsAlarmRef=Alarm_Work, RteBswUsedOsEventRef=Ev_Work:
          Work1ms: RteBswPositionInTask=1, RteBswEventRef=Can_MainFunction_Wakeup_1ms
          Can_MainFunction_Read: RteBswPositionInTask=9, RteBswEventRef=Can_MainFunction_Read_1ms
          Can_MainFunction_Write: RteBswPositionInTask=10, RteBswEventRef=Can_MainFunction_Write_1ms
          Can_MainFunction_Mode: RteBswPositionInTask=11, RteBswEventRef=Can_MainFunction_Mode_1ms
          Can_MainFunction_BusOff: RteBswPositionInTask=12, RteBswEventRef=Can_MainFunction_BusOff_1ms
      CanTp: RteBswImplementationRef=CanTp_Implementation
        Work1ms (RteBswEventToTaskMapping):
          RteBswEventIsMappedToTask = true
          RteBswPositionInTask = 2
          RteBswEventRef = CanTp_MainFunction_1ms
          RteBswMappedToTaskRef = Task_Ecu
          RteBswUsedOsAlarmRef = Alarm_Work
          RteBswUsedOsEventRef = Ev_Work
      Com: RteBswImplementationRef=Com_Implementation
        Work1ms (RteBswEventToTaskMapping):
          RteBswEventIsMappedToTask = true
          RteBswPositionInTask = 3
          RteBswEventRef = Com_MainFunctionRx_Rx_1ms
          RteBswMappedToTaskRef = Task_Ecu
          RteBswUsedOsAlarmRef = Alarm_Work
          RteBswUsedOsEventRef = Ev_Work
        Transmit10ms (RteBswEventToTaskMapping):
          RteBswEventIsMappedToTask = true
          RteBswPositionInTask = 7
          RteBswEventRef = Com_MainFunctionTx_Tx_10ms
          RteBswMappedToTaskRef = Task_Ecu
          RteBswUsedOsAlarmRef = Alarm_App
          RteBswUsedOsEventRef = Ev_App
      Dcm: RteBswImplementationRef=Dcm_Implementation
        Work1ms (RteBswEventToTaskMapping):
          RteBswEventIsMappedToTask = true
          RteBswPositionInTask = 8
          RteBswEventRef = Dcm_MainFunction_1ms
          RteBswMappedToTaskRef = Task_Ecu
          RteBswUsedOsAlarmRef = Alarm_Work
          RteBswUsedOsEventRef = Ev_Work
    3 x RteSwComponentInstance:
      Process: RteSoftwareComponentInstanceRef=ProcessInstance
        Periodic10ms (RteEventToTaskMapping):
          RteEventIsMappedToTask = true
          RtePositionInTask = 5
          RteEventRef = Periodic10ms
          RteMappedToTaskRef = Task_Ecu
          RteUsedOsAlarmRef = Alarm_App
          RteUsedOsEventRef = Ev_App
        ReadApplicationValue (RteEventToTaskMapping): RteEventIsMappedToTask=false, RteEventRef=InvokeTransform
      Observe: RteSoftwareComponentInstanceRef=ObserveInstance
        Periodic10ms (RteEventToTaskMapping):
          RteEventIsMappedToTask = true
          RtePositionInTask = 6
          RteEventRef = Periodic10ms
          RteMappedToTaskRef = Task_Ecu
          RteUsedOsAlarmRef = Alarm_App
          RteUsedOsEventRef = Ev_App
      DcmService: RteSoftwareComponentInstanceRef=DcmService
        4 x RteEventToTaskMapping, all with RteEventIsMappedToTask=false:
          GetSecurityLevel: RteEventRef=InvokeGetSecurityLevel
          GetSesCtrlType: RteEventRef=InvokeGetSesCtrlType
          ResetToDefaultSession: RteEventRef=InvokeResetToDefaultSession
          SetActiveDiagnostic: RteEventRef=InvokeSetActiveDiagnostic
    ComM (RteBswModuleInstance): RteBswImplementationRef=ComM_Implementation
      ComM_MainFunction_Host (RteBswEventToTaskMapping):
        RteBswEventIsMappedToTask = true
        RteBswPositionInTask = 0
        RteBswEventRef = ComM_MainFunction_Host_1ms
        RteBswMappedToTaskRef = Task_Ecu
        RteBswUsedOsAlarmRef = Alarm_Work
        RteBswUsedOsEventRef = Ev_Work
    ComMService (RteSwComponentInstance): RteSoftwareComponentInstanceRef=ComMService
      5 x RteEventToTaskMapping, all with RteEventIsMappedToTask=false:
        GetCurrentComMode: RteEventRef=InvokeGetCurrentComMode
        GetCurrentPNCComMode: RteEventRef=InvokeGetCurrentPNCComMode
        GetMaxComMode: RteEventRef=InvokeGetMaxComMode
        GetRequestedComMode: RteEventRef=InvokeGetRequestedComMode
        RequestComMode: RteEventRef=InvokeRequestComMode
  module config EcuC: ecuc-def-edition=4.10.0, implementation-config-variant=VARIANT-PRE-COMPILE, post-build-variant-used=false
    Config (EcucConfigSet)
      Pdus (EcucPduCollection): PduIdTypeEnum=UINT16, PduLengthTypeEnum=UINT16
        6 x Pdu:
          RxValuePdu: PduLength=4
          TxValuePdu: PduLength=4
          DiagRequestPdu: PduLength=8
          DiagResponsePdu: PduLength=8
          DiagRequestSdu: PduLength=64
          DiagResponseSdu: PduLength=64
    Hardware (EcucHardware)
      VirtualCore (EcucCoreDefinition): EcucCoreId=0
    Partitions (EcucPartitionCollection)
      OwnerPartition (EcucPartition):
        EcucPartitionId = 0
        EcucPartitionCoreRef = VirtualCore
        EcucPartitionSoftwareComponentInstanceRef = RootComposition.IngressInstance
        EcucPartitionSoftwareComponentInstanceRef = RootComposition.ProcessInstance
        EcucPartitionSoftwareComponentInstanceRef = RootComposition.ObserveInstance
        EcucPartitionSoftwareComponentInstanceRef = RootComposition.DcmService
        EcucPartitionSoftwareComponentInstanceRef = RootComposition.ComMService
  module config Com: ecuc-def-edition=4.10.0, implementation-config-variant=VARIANT-PRE-COMPILE, post-build-variant-used=false
    Config (ComConfig)
      RxGroup (ComIPduGroup): ComIPduGroupHandleId=0
      Rx (ComMainFunctionRx): ComMainRxTimeBase=0.001, ComMainRxPartitionRef=OwnerPartition
      Tx (ComMainFunctionTx): ComMainTxTimeBase=0.01, ComMainTxPartitionRef=OwnerPartition
      RxValue (ComSignal):
        ComBitPosition = 0
        ComBitSize = 32
        ComSignalType = UINT32
        ComSignalEndianness = LITTLE_ENDIAN
        ComSignalInitValue = 0
        ComTransferProperty = PENDING
        ComTimeout = 0.03
        ComFirstTimeout = 0
        ComRxDataTimeoutAction = NONE
        ComSystemTemplateSystemSignalRef = RxValueMap
      RxValuePdu (ComIPdu):
        ComIPduDirection = RECEIVE
        ComIPduSignalProcessing = IMMEDIATE
        ComIPduType = NORMAL
        ComIPduMainFunctionRef = Rx
        ComIPduGroupRef = RxGroup
        ComIPduSignalRef = Config/RxValue
        ComPduIdRef = Pdus/RxValuePdu
      TxValue (ComSignal):
        ComBitPosition = 0
        ComBitSize = 32
        ComSignalType = UINT32
        ComSignalEndianness = LITTLE_ENDIAN
        ComSignalInitValue = 0
        ComTransferProperty = PENDING
        ComSystemTemplateSystemSignalRef = TxValueMap
      TxValuePdu (ComIPdu):
        ComIPduDirection = SEND
        ComIPduSignalProcessing = IMMEDIATE
        ComIPduType = NORMAL
        ComIPduMainFunctionRef = Tx
        ComIPduSignalRef = Config/TxValue
        ComPduIdRef = Pdus/TxValuePdu
        Transmit (ComTxIPdu): ComTxIPduUnusedAreasDefault=0, ComMinimumDelayTime=0
          ModeTrue (ComTxModeTrue)
            Periodic (ComTxMode): ComTxModeMode=PERIODIC, ComTxModeTimePeriod=0.01
    General (ComGeneral): ComEnableSecurityEventReporting=false, ComEnableSignalGroupArrayApi=false, ComSupportedIPduGroups=1, ComVersionInfoApi=false
  module config Dcm: ecuc-def-edition=4.10.0, implementation-config-variant=VARIANT-PRE-COMPILE, post-build-variant-used=false
    Config (DcmConfigSet)
      Dsp (DcmDsp): DcmDspMaxDidToRead=2, DcmDspDataDefaultEndianness=LITTLE_ENDIAN, DcmDspEnableObdMirror=false
        ApplicationValue (DcmDspData):
          DcmDspDataUsePort = USE_DATA_SYNCH_CLIENT_SERVER
          DcmDspDataType = UINT8_N
          DcmDspDataByteSize = 4
          DcmDspDataEndianness = opaque
          DcmDspDataConditionCheckReadFncUsed = false
          DcmDspDataInfoRef = ApplicationValueInfo
        ApplicationValueInfo (DcmDspDataInfo): DcmDspDataScalingInfoSize=0
        ApplicationDid (DcmDspDid): DcmDspDidIdentifier=4660, DcmDspDidUsePort=USE_DATA_ELEMENT_SPECIFIC_INTERFACES, DcmDspDidUsed=true, DcmDspDidInfoRef=ApplicationDidInfo
          Value (DcmDspDidSignal): DcmDspDidByteOffset=0, DcmDspDidDataRef=ApplicationValue
        ApplicationDidInfo (DcmDspDidInfo): DcmDspDidDynamicallyDefined=false
          Read (DcmDspDidRead): DcmDspDidReadSessionRef=DCM_DEFAULT_SESSION, DcmDspDidReadSessionRef=DCM_EXTENDED_DIAGNOSTIC_SESSION
        Sessions (DcmDspSession)
          DCM_DEFAULT_SESSION (DcmDspSessionRow): DcmDspSessionLevel=1, DcmDspSessionForBoot=DCM_NO_BOOT, DcmDspSessionP2ServerMax=0.05, DcmDspSessionP2StarServerMax=5
          DCM_EXTENDED_DIAGNOSTIC_SESSION (DcmDspSessionRow): DcmDspSessionLevel=3, DcmDspSessionForBoot=DCM_NO_BOOT, DcmDspSessionP2ServerMax=0.05, DcmDspSessionP2StarServerMax=5
        Security (DcmDspSecurity)
      Dsl (DcmDsl)
        RxBuffer (DcmDslBuffer): DcmDslBufferSize=64
        TxBuffer (DcmDslBuffer): DcmDslBufferSize=64
        Protocols (DcmDslProtocol)
          UdsOnCan (DcmDslProtocolRow):
            DcmDslProtocolPriority = 0
            DcmDslProtocolRowUsed = true
            DcmDslProtocolType = DCM_UDS_ON_CAN
            DcmSendRespPendOnRestart = false
            DcmTimStrP2ServerAdjust = 0
            DcmTimStrP2StarServerAdjust = 0
            DcmDslProtocolRxBufferRef = RxBuffer
            DcmDslProtocolTxBufferRef = TxBuffer
            DcmDslProtocolSIDTable = Services
            DcmDemClientRef = Client
            Connection (DcmDslConnection)
              Physical (DcmDslMainConnection): DcmDslProtocolRxConnectionId=0, DcmDslProtocolComMChannelRef=Host
                Receive (DcmDslProtocolRx): DcmDslProtocolRxAddrType=DCM_PHYSICAL_TYPE, DcmDslProtocolRxPduId=0, DcmDslProtocolRxPduRef=DiagRequestSdu
                Transmit (DcmDslProtocolTx): DcmDslTxConfirmationPduId=0, DcmDslProtocolTxPduRef=DiagResponseSdu
        ResponsePolicy (DcmDslDiagResp): DcmDslDiagRespOnSecondDeclinedRequest=false
      Dsd (DcmDsd)
        Services (DcmDsdServiceTable): DcmDsdSidTabId=0
          3 x DcmDsdService, all with DcmDsdServiceUsed=true:
            SessionControl: DcmDsdSidTabServiceId=16, DcmDsdSidTabSubfuncAvail=true
              Default (DcmDsdSubService): DcmDsdSubServiceId=1, DcmDsdSubServiceUsed=true
              Extended (DcmDsdSubService): DcmDsdSubServiceId=3, DcmDsdSubServiceUsed=true
            ReadDataByIdentifier: DcmDsdSidTabServiceId=34, DcmDsdSidTabSubfuncAvail=false
            TesterPresent: DcmDsdSidTabServiceId=62, DcmDsdSidTabSubfuncAvail=true
              Present (DcmDsdSubService): DcmDsdSubServiceId=0, DcmDsdSubServiceUsed=true
      PageBuffer (DcmPageBufferCfg): DcmPagedBufferEnabled=false
    General (DcmGeneral): DcmTaskTime=0.001, DcmDevErrorDetect=false, DcmEnableSecurityEventReporting=false, DcmRespondAllRequest=false, DcmVersionInfoApi=false
  module config Can: ecuc-def-edition=4.10.0, implementation-config-variant=VARIANT-PRE-COMPILE, post-build-variant-used=false
    Config (CanConfigSet)
      Controller (CanController):
        CanControllerId = 0
        CanControllerActivation = true
        CanRxProcessing = POLLING
        CanTxProcessing = POLLING
        CanBusoffProcessing = POLLING
        CanWakeupProcessing = POLLING
        CanWakeupSupport = false
        CanHwPnSupport = false
        CanControllerBaseAddress = 0
        CanControllerDefaultBaudrate = Baudrate
        CanCpuClockRef = ClockReference
        Baudrate (CanControllerBaudrateConfig):
          CanControllerBaudRate = 500
          CanControllerBaudRateConfigID = 0
          CanControllerPropSeg = 6
          CanControllerSeg1 = 7
          CanControllerSeg2 = 2
          CanControllerSyncJumpWidth = 1
      Receive (CanHardwareObject):
        CanHandleType = BASIC
        CanHwObjectCount = 1
        CanIdType = STANDARD
        CanObjectId = 0
        CanObjectType = RECEIVE
        CanMainFunctionRWPeriodRef = Polling
        CanControllerRef = Config/Controller
      Transmit (CanHardwareObject):
        CanHandleType = BASIC
        CanHwObjectCount = 1
        CanIdType = STANDARD
        CanObjectId = 1
        CanObjectType = TRANSMIT
        CanMainFunctionRWPeriodRef = Polling
        CanControllerRef = Config/Controller
    General (CanGeneral):
      CanDevErrorDetect = false
      CanEnableSecurityEventReporting = false
      CanGlobalTimeSupport = false
      CanIndex = 0
      CanMainFunctionBusoffPeriod = 0.001
      CanMainFunctionModePeriod = 0.001
      CanMultiplexedTransmission = false
      CanTimeoutDuration = 0.001
      CanVersionInfoApi = false
      CanSupportTTCANRef = Private
      Polling (CanMainFunctionRWPeriods): CanMainFunctionPeriod=0.001
  module config CanIf: ecuc-def-edition=4.10.0, implementation-config-variant=VARIANT-PRE-COMPILE, post-build-variant-used=false
    Config (CanIfInitCfg): CanIfInitCfgSet=VirtualCanConfiguration
      Handles (CanIfInitHohCfg)
        Receive (CanIfHrhCfg): CanIfHrhSoftwareFilter=true, CanIfHrhCanCtrlIdRef=Controller/Controller, CanIfHrhIdSymRef=Config/Receive
        Transmit (CanIfHthCfg): CanIfHthCanCtrlIdRef=Controller/Controller, CanIfHthIdSymRef=Config/Transmit
      TransmitBuffer (CanIfBufferCfg): CanIfBufferSize=0, CanIfBufferHthRef=Handles/Transmit
      RxValue (CanIfRxPduCfg):
        CanIfRxPduCanId = 800
        CanIfRxPduCanIdType = STANDARD_NO_FD_CAN
        CanIfRxPduId = 0
        CanIfRxPduReadNotifyStatus = false
        CanIfRxPduDataLength = 4
        CanIfRxPduDataLengthCheck = true
        CanIfRxPduReadData = false
        CanIfRxPduRef = Pdus/RxValuePdu
        CanIfRxPduHrhIdRef = Handles/Receive
      TxValue (CanIfTxPduCfg):
        CanIfTxPduCanId = 801
        CanIfTxPduCanIdType = STANDARD_CAN
        CanIfTxPduId = 0
        CanIfTxPduReadNotifyStatus = false
        CanIfTxPduType = STATIC
        CanIfTxPduTruncation = false
        CanIfTxPduRef = Pdus/TxValuePdu
        CanIfTxPduBufferRef = TransmitBuffer
      DiagRequest (CanIfRxPduCfg):
        CanIfRxPduCanId = 1792
        CanIfRxPduCanIdType = STANDARD_NO_FD_CAN
        CanIfRxPduId = 1
        CanIfRxPduReadNotifyStatus = false
        CanIfRxPduDataLength = 8
        CanIfRxPduDataLengthCheck = true
        CanIfRxPduReadData = false
        CanIfRxPduRef = DiagRequestPdu
        CanIfRxPduHrhIdRef = Handles/Receive
      DiagResponse (CanIfTxPduCfg):
        CanIfTxPduCanId = 1800
        CanIfTxPduCanIdType = STANDARD_CAN
        CanIfTxPduId = 1
        CanIfTxPduReadNotifyStatus = false
        CanIfTxPduType = STATIC
        CanIfTxPduTruncation = false
        CanIfTxPduRef = DiagResponsePdu
        CanIfTxPduBufferRef = TransmitBuffer
    Controller (CanIfCtrlDrvCfg): CanIfCtrlDrvInitHohConfigRef=Handles, CanIfCtrlDrvNameRef=Can/General
      Controller (CanIfCtrlCfg): CanIfCtrlId=0, CanIfCtrlWakeupSupport=false, CanIfCtrlCanCtrlRef=Config/Controller
    Dispatch (CanIfDispatchCfg):
      CanIfDispatchUserCtrlBusOffName = Ecu_HostBusSM_ControllerBusOff
      CanIfDispatchUserCtrlModeIndicationName = Ecu_HostBusSM_ControllerModeIndication
      CanIfDispatchUserCtrlBusOffUL = CDD
      CanIfDispatchUserCtrlModeIndicationUL = CDD
    Private (CanIfPrivateCfg): CanIfFixedBuffer=false, CanIfPrivateDataLengthCheck=true, CanIfPrivateSoftwareFilterType=LINEAR, CanIfSupportTTCAN=false
    Public (CanIfPublicCfg):
      CanIfBusMirroringSupport = false
      CanIfDevErrorDetect = false
      CanIfEnableSecurityEventReporting = false
      CanIfGlobalTimeSupport = false
      CanIfPublicCtrlPnEnable = false
      CanIfPublicHandleTypeEnum = UINT16
      CanIfPublicMultipleDrvSupport = false
      CanIfPublicPnSupport = false
      CanIfPublicReadRxPduDataApi = false
      CanIfPublicReadRxPduNotifyStatusApi = false
      CanIfPublicReadTxPduNotifyStatusApi = false
      CanIfPublicSetDynamicTxIdApi = false
      CanIfPublicTrcvPnEnable = false
      CanIfPublicTxBuffering = false
      CanIfPublicTxConfirmPollingSupport = false
      CanIfPublicWakeupCheckValidSupport = false
      CanIfTriggerTransmitSupport = false
      CanIfTxOfflineActiveSupport = false
      CanIfVersionInfoApi = false
      CanIfWakeupSupport = false
  module config CanTp: ecuc-def-edition=4.10.0, implementation-config-variant=VARIANT-PRE-COMPILE, post-build-variant-used=false
    Config (CanTpConfig): CanTpMainFunctionPeriod=0.001
      PhysicalChannel (CanTpChannel)
        DiagRequest (CanTpRxNSdu):
          CanTpRxAddressingFormat = CANTP_STANDARD
          CanTpRxNSduId = 0
          CanTpRxPaddingActivation = CANTP_ON
          CanTpRxTaType = CANTP_PHYSICAL
          CanTpNar = 0.2
          CanTpNbr = 0.2
          CanTpNcr = 0.2
          CanTpBs = 0
          CanTpSTmin = 0
          CanTpRxWftMax = 0
          CanTpRxNSduRef = DiagRequestSdu
          Frame (CanTpRxNPdu): CanTpRxNPduId=0, CanTpRxNPduRef=DiagRequestPdu
          FlowControl (CanTpTxFcNPdu): CanTpTxFcNPduConfirmationPduId=0, CanTpTxFcNPduRef=DiagResponsePdu
        DiagResponse (CanTpTxNSdu):
          CanTpTxAddressingFormat = CANTP_STANDARD
          CanTpTxNSduId = 0
          CanTpTxPaddingActivation = CANTP_ON
          CanTpTxTaType = CANTP_PHYSICAL
          CanTpNas = 0.2
          CanTpNbs = 0.2
          CanTpNcs = 0.2
          CanTpTc = false
          CanTpTxNSduRef = DiagResponseSdu
          Frame (CanTpTxNPdu): CanTpTxNPduConfirmationPduId=0, CanTpTxNPduRef=DiagResponsePdu
          FlowControl (CanTpRxFcNPdu): CanTpRxFcNPduId=0, CanTpRxFcNPduRef=DiagRequestPdu
    General (CanTpGeneral):
      CanTpPaddingByte = 0
      CanTpChangeParameterApi = false
      CanTpDevErrorDetect = false
      CanTpEnableSecurityEventReporting = false
      CanTpReadParameterApi = false
      CanTpVersionInfoApi = false
  module config PduR: ecuc-def-edition=4.10.0, implementation-config-variant=VARIANT-PRE-COMPILE, post-build-variant-used=false
    General (PduRGeneral): PduRDevErrorDetect=false, PduRMetaDataSupport=false, PduRVersionInfoApi=false, PduRZeroCostOperation=false
    Routes (PduRRoutingPaths): PduRConfigurationId=0
      RxValueSource (PduRSrcPdu): PduRSourcePduHandleId=0, PduRSrcPduUpTxConf=true, PduRSrcPduRef=Pdus/RxValuePdu
      RxValueDestination (PduRDestPdu): PduRDestPduHandleId=0, PduRTransmissionConfirmation=true, PduRDestPduRef=Pdus/RxValuePdu
      RxValue (PduRRoutingPath): PduRSrcPduRRef=RxValueSource, PduRDestPduRRef=RxValueDestination
      TxValueSource (PduRSrcPdu): PduRSourcePduHandleId=1, PduRSrcPduUpTxConf=true, PduRSrcPduRef=Pdus/TxValuePdu
      TxValueDestination (PduRDestPdu): PduRDestPduHandleId=1, PduRTransmissionConfirmation=true, PduRDestPduRef=Pdus/TxValuePdu
      TxValue (PduRRoutingPath): PduRSrcPduRRef=TxValueSource, PduRDestPduRRef=TxValueDestination
      DiagRequestSource (PduRSrcPdu): PduRSourcePduHandleId=2, PduRSrcPduUpTxConf=true, PduRSrcPduRef=DiagRequestSdu
      DiagRequestDestination (PduRDestPdu): PduRDestPduHandleId=2, PduRTransmissionConfirmation=true, PduRDestPduRef=DiagRequestSdu
      DiagRequest (PduRRoutingPath): PduRSrcPduRRef=DiagRequestSource, PduRDestPduRRef=DiagRequestDestination
      DiagResponseSource (PduRSrcPdu): PduRSourcePduHandleId=3, PduRSrcPduUpTxConf=true, PduRSrcPduRef=DiagResponseSdu
      DiagResponseDestination (PduRDestPdu): PduRDestPduHandleId=3, PduRTransmissionConfirmation=true, PduRDestPduRef=DiagResponseSdu
      DiagResponse (PduRRoutingPath): PduRSrcPduRRef=DiagResponseSource, PduRDestPduRRef=DiagResponseDestination
  module config Mcu: ecuc-def-edition=4.10.0, implementation-config-variant=VARIANT-PRE-COMPILE, post-build-variant-used=false
    General (McuGeneralConfiguration): McuDevErrorDetect=false, McuGetRamStateApi=false, McuInitClock=true, McuNoPll=true, McuPerformResetApi=false, McuVersionInfoApi=false
    Module (McuModuleConfiguration): McuClockSrcFailureNotification=DISABLED, McuNumberOfMcuModes=1, McuRamSectors=0
      Clock (McuClockSettingConfig): McuClockSettingId=0
        ClockReference (McuClockReferencePoint): McuClockReferencePointFrequency=80000000
      Mode (McuModeSettingConf): McuMode=0
    Published (McuPublishedInformation)
      PowerOnReset (McuResetReasonConf): McuResetReason=0
  module config Dem: ecuc-def-edition=4.10.0, implementation-config-variant=VARIANT-PRE-COMPILE, post-build-variant-used=false
    Config (DemConfigSet)
      UnavailableControllerEvent (DemEventParameter):
        DemEventAvailable = false
        DemEventConfirmationThreshold = 1
        DemEventId = 1
        DemEventKind = DEM_EVENT_KIND_BSW
        DemEventReportingType = STANDARD_REPORTING
        DemFFPrestorageSupported = false
        DemOperationCycleRef = OperationCycle
        Debounce (DemDebounceAlgorithmClass)
          MonitorInternal (DemDebounceMonitorInternal)
    General (DemGeneral):
      DemAgingRequiresNotFailedCycle = false
      DemAgingRequiresTestedCycle = false
      DemAvailabilitySupport = DEM_EVENT_AVAILABILITY
      DemClearDTCBehavior = DEM_CLRRESP_VOLATILE
      DemClearDTCLimitation = DEM_ALL_SUPPORTED_DTCS
      DemDataElementDefaultEndianness = LITTLE_ENDIAN
      DemDebounceCounterBasedSupport = false
      DemDebounceTimeBasedSupport = false
      DemDevErrorDetect = false
      DemEventCombinationSupport = DEM_EVCOMB_DISABLED
      DemGeneralInterfaceSupport = false
      DemMaxNumberPrestoredFF = 0
      DemOBDSupport = DEM_OBD_NO_OBD_SUPPORT
      DemPTOSupport = false
      DemResetConfirmedBitOnOverflow = false
      DemResetPendingBitOnOverflow = false
      DemStatusBitHandlingTestFailedSinceLastClear = DEM_STATUS_BIT_NORMAL
      DemStatusBitStorageTestFailed = false
      DemSuppressionSupport = DEM_NO_SUPPRESSION
      DemTaskTime = 0.001
      DemTriggerFiMReports = false
      DemTriggerMonitorInitBeforeClearOk = false
      DemVersionInfoApi = false
      Client (DemClient): DemClientFunctionality=DEM_CLIENT_USES_FULL_FUNCTIONALITY, DemClientId=0, DemClientUsesRte=false, DemEventMemorySetRef=MemorySet
      MemorySet (DemEventMemorySet): DemMaxNumberEventEntryPermanent=0, DemTypeOfDTCSupported=DEM_DTC_TRANSLATION_ISO14229_1
        Primary (DemPrimaryMemory):
          DemDtcStatusAvailabilityMask = 255
          DemEventDisplacementStrategy = DEM_DISPLACEMENT_NONE
          DemEventMemoryEntryStorageTrigger = DEM_TRIGGER_ON_CONFIRMED
          DemMaxNumberEventEntryPrimary = 1
          DemOccurrenceCounterProcessing = DEM_PROCESS_OCCCTR_CDTC
          DemTypeOfFreezeFrameRecordNumeration = DEM_FF_RECNUM_CONFIGURED
      OperationCycle (DemOperationCycle): DemOperationCycleId=0
  module config ComM: ecuc-def-edition=4.10.0, implementation-config-variant=VARIANT-PRE-COMPILE, post-build-variant-used=false
    General (ComMGeneral):
      ComMDevErrorDetect = false
      ComMDynamicPncToChannelMappingSupport = false
      ComMModeLimitationEnabled = false
      ComMPncSupport = false
      ComMResetAfterForcingNoComm = false
      ComMSynchronousWakeUp = false
      ComMVersionInfoApi = false
      ComMWakeupInhibitionEnabled = false
      ComMEcuGroupClassification = 3
      ComMTMinFullComModeDuration = 0.005
    Config (ComMConfigSet)
      Host (ComMChannel):
        ComMBusType = COMM_BUS_TYPE_CDD
        ComMChannelId = 0
        ComMCDDBusPrefix = Ecu_HostBusSM
        ComMMainFunctionPeriod = 0.001
        ComMFullCommRequestNotificationEnabled = false
        ComMNoCom = false
        ComMNoWakeup = false
        ComMNoWakeUpInhibitionNvmStorage = false
        NetworkManagement (ComMNetworkManagement): ComMNmVariant=NONE
        User (ComMUserPerChannel): ComMUserChannel=HostUser
      HostUser (ComMUser): ComMUserIdentifier=0
  module config BswM: ecuc-def-edition=4.10.0, implementation-config-variant=VARIANT-PRE-COMPILE, post-build-variant-used=false
    General (BswMGeneral):
      BswMCanSMEnabled = false
      BswMComMEnabled = true
      BswMDcmEnabled = false
      BswMDevErrorDetect = false
      BswMEcuMEnabled = false
      BswMEthIfEnabled = false
      BswMEthSMEnabled = false
      BswMFrSMEnabled = false
      BswMGenericRequestEnabled = false
      BswMJ1939DcmEnabled = false
      BswMJ1939NmEnabled = false
      BswMLinSMEnabled = false
      BswMLinTPEnabled = false
      BswMNmEnabled = false
      BswMNvMEnabled = false
      BswMSdControlEnabled = false
      BswMSdEnabled = false
      BswMVersionInfoApi = false
      Includes (BswMUserIncludeFiles): BswMUserIncludeFile=Ecu_HostBusSM.h
    Config (BswMConfig)
      Arbitration (BswMArbitration)
        CurrentMode (BswMModeRequestPort): BswMRequestProcessing=BSWM_IMMEDIATE
          Initial (BswMModeInitValue): BswMBswModeInitValue=COMM_NO_COMMUNICATION
          Source (BswMModeRequestSource)
            ComM (BswMComMIndication): BswMComMChannelRef=Host
        NoCondition (BswMModeCondition): BswMConditionType=BSWM_EQUALS, BswMConditionMode=CurrentMode
          Expected (BswMConditionValue)
            Mode (BswMBswMode): BswMBswRequestedMode=COMM_NO_COMMUNICATION
        NoExpression (BswMLogicalExpression): BswMArgumentRef=NoCondition
        NoRule (BswMRule): BswMRuleInitState=BSWM_FALSE, BswMNestedExecutionOnly=false, BswMRuleExpressionRef=NoExpression, BswMRuleTrueActionList=NoList
        SilentCondition (BswMModeCondition): BswMConditionType=BSWM_EQUALS, BswMConditionMode=CurrentMode
          Expected (BswMConditionValue)
            Mode (BswMBswMode): BswMBswRequestedMode=COMM_SILENT_COMMUNICATION
        SilentExpression (BswMLogicalExpression): BswMArgumentRef=SilentCondition
        SilentRule (BswMRule): BswMRuleInitState=BSWM_FALSE, BswMNestedExecutionOnly=false, BswMRuleExpressionRef=SilentExpression, BswMRuleTrueActionList=SilentList
        FullCondition (BswMModeCondition): BswMConditionType=BSWM_EQUALS, BswMConditionMode=CurrentMode
          Expected (BswMConditionValue)
            Mode (BswMBswMode): BswMBswRequestedMode=COMM_FULL_COMMUNICATION
        FullExpression (BswMLogicalExpression): BswMArgumentRef=FullCondition
        FullRule (BswMRule): BswMRuleInitState=BSWM_FALSE, BswMNestedExecutionOnly=false, BswMRuleExpressionRef=FullExpression, BswMRuleTrueActionList=FullList
      Control (BswMModeControl)
        NoAction (BswMAction)
          Available (BswMAvailableActions)
            Callout (BswMUserCallout): BswMUserCalloutFunction=Ecu_HostBusSM_ConfirmMode(0u, COMM_NO_COMMUNICATION)
        NoList (BswMActionList): BswMActionListExecution=BSWM_CONDITION
          Item (BswMActionListItem): BswMActionListItemIndex=0, BswMAbortOnFail=false, BswMActionListItemRef=NoAction
        SilentAction (BswMAction)
          Available (BswMAvailableActions)
            Callout (BswMUserCallout): BswMUserCalloutFunction=Ecu_HostBusSM_ConfirmMode(0u, COMM_SILENT_COMMUNICATION)
        SilentList (BswMActionList): BswMActionListExecution=BSWM_CONDITION
          Item (BswMActionListItem): BswMActionListItemIndex=0, BswMAbortOnFail=false, BswMActionListItemRef=SilentAction
        FullAction (BswMAction)
          Available (BswMAvailableActions)
            Callout (BswMUserCallout): BswMUserCalloutFunction=Ecu_HostBusSM_ConfirmMode(0u, COMM_FULL_COMMUNICATION)
        FullList (BswMActionList): BswMActionListExecution=BSWM_CONDITION
          Item (BswMActionListItem): BswMActionListItemIndex=0, BswMAbortOnFail=false, BswMActionListItemRef=FullAction
  module config Det: implementation-config-variant=VARIANT-PRE-COMPILE
    General (DetGeneral): DetVersionInfoApi=false
    Notification (DetNotification): DetReportRuntimeErrorCallout=Ecu_DetRuntimeCallout
