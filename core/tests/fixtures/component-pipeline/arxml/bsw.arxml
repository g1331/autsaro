AUTOSAR XML (schema 00053)
package /SelectedBswTypes
  12 x base type, all with category=FIXED_LENGTH, base-type-encoding=NONE:
    Native0: base-type-size=64, native-declaration=const CanIf_ConfigType *
    Native1: base-type-size=8, native-declaration=Std_ReturnType
    Native2: base-type-size=16, native-declaration=PduIdType
    Native3: base-type-size=64, native-declaration=const PduInfoType *
    Native4: base-type-size=64, native-declaration=const PduR_PBConfigType *
    Native5: base-type-size=64, native-declaration=const CanTp_ConfigType *
    Native6: base-type-size=64, native-declaration=const Com_ConfigType *
    Native7: base-type-size=8, native-declaration=uint8
    Native8: base-type-size=16, native-declaration=Com_SignalIdType
    Native9: base-type-size=64, native-declaration=const void *
    Native10: base-type-size=64, native-declaration=void *
    Native11: base-type-size=64, native-declaration=const Dcm_ConfigType *
package /AUTOSAR_Can
  bsw module description Can: category=BSW_MODULE, module-id=80
    implemented-entrys:
      Can_Init
      Can_MainFunction_Wakeup
      Can_MainFunction_Read
      Can_MainFunction_Write
      Can_MainFunction_Mode
      Can_MainFunction_BusOff
    bsw internal behavior Behavior
      5 x bsw schedulable entity:
        Can_MainFunction_Wakeup_Entity: implemented-entry=Can_MainFunction_Wakeup
        Can_MainFunction_Read_Entity: implemented-entry=Can_MainFunction_Read
        Can_MainFunction_Write_Entity: implemented-entry=Can_MainFunction_Write
        Can_MainFunction_Mode_Entity: implemented-entry=Can_MainFunction_Mode
        Can_MainFunction_BusOff_Entity: implemented-entry=Can_MainFunction_BusOff
      5 x bsw timing event, all with period=0.001:
        Can_MainFunction_Wakeup_1ms: starts-on-event=Can_MainFunction_Wakeup_Entity
        Can_MainFunction_Read_1ms: starts-on-event=Can_MainFunction_Read_Entity
        Can_MainFunction_Write_1ms: starts-on-event=Can_MainFunction_Write_Entity
        Can_MainFunction_Mode_1ms: starts-on-event=Can_MainFunction_Mode_Entity
        Can_MainFunction_BusOff_1ms: starts-on-event=Can_MainFunction_BusOff_Entity
  bsw implementation Can_Implementation: programming-language=C, sw-version=0.1.0, ar-release-version=4.10.0, behavior=Can/Behavior
package /AUTOSAR_Can/BswModuleEntrys
  6 x bsw module entry, all with is-reentrant=false, is-synchronous=true, sw-service-impl-policy=STANDARD, bsw-entry-kind=CONCRETE:
    Can_Init: call-type=REGULAR, execution-context=UNSPECIFIED
      sw service arg config: category=VALUE, direction=IN, base-type=Host_CanConfigPointer
    Can_MainFunction_Wakeup: call-type=SCHEDULED, execution-context=TASK
    Can_MainFunction_Read: call-type=SCHEDULED, execution-context=TASK
    Can_MainFunction_Write: call-type=SCHEDULED, execution-context=TASK
    Can_MainFunction_Mode: call-type=SCHEDULED, execution-context=TASK
    Can_MainFunction_BusOff: call-type=SCHEDULED, execution-context=TASK
package /AUTOSAR_CanIf
  bsw module description CanIf: category=BSW_MODULE, implemented-entrys=[CanIf_Init, CanIf_Transmit], module-id=60
    bsw internal behavior Behavior
  bsw implementation CanIf_Implementation: programming-language=C, sw-version=0.1.0, ar-release-version=4.10.0, behavior=CanIf/Behavior
package /AUTOSAR_CanIf/BswModuleEntrys
  bsw module entry CanIf_Init: is-reentrant=false, is-synchronous=true, call-type=REGULAR, execution-context=UNSPECIFIED, sw-service-impl-policy=STANDARD, bsw-entry-kind=CONCRETE
    sw service arg Config: category=VALUE, direction=IN, base-type=Native0
  bsw module entry CanIf_Transmit: is-reentrant=true, is-synchronous=true, call-type=REGULAR, execution-context=TASK, sw-service-impl-policy=STANDARD, bsw-entry-kind=CONCRETE
    return type ReturnValue: category=VALUE, direction=OUT, base-type=Native1
    sw service arg PduId: category=VALUE, direction=IN, base-type=Native2
    sw service arg PduInfo: category=VALUE, direction=IN, base-type=Native3
package /AUTOSAR_PduR
  bsw module description PduR: category=BSW_MODULE, implemented-entrys=[PduR_Init, PduR_ComTransmit], module-id=51
    bsw internal behavior Behavior
  bsw implementation PduR_Implementation: programming-language=C, sw-version=0.1.0, ar-release-version=4.10.0, behavior=PduR/Behavior
package /AUTOSAR_PduR/BswModuleEntrys
  bsw module entry PduR_Init: is-reentrant=false, is-synchronous=true, call-type=REGULAR, execution-context=UNSPECIFIED, sw-service-impl-policy=STANDARD, bsw-entry-kind=CONCRETE
    sw service arg Config: category=VALUE, direction=IN, base-type=Native4
  bsw module entry PduR_ComTransmit: is-reentrant=true, is-synchronous=true, call-type=REGULAR, execution-context=TASK, sw-service-impl-policy=STANDARD, bsw-entry-kind=CONCRETE
    return type ReturnValue: category=VALUE, direction=OUT, base-type=Native1
    sw service arg PduId: category=VALUE, direction=IN, base-type=Native2
    sw service arg PduInfo: category=VALUE, direction=IN, base-type=Native3
package /AUTOSAR_CanTp
  bsw module description CanTp: category=BSW_MODULE, implemented-entrys=[CanTp_Init, CanTp_MainFunction], module-id=35
    bsw internal behavior Behavior
      bsw schedulable entity CanTp_MainFunction_Entity: implemented-entry=CanTp_MainFunction
      bsw timing event CanTp_MainFunction_1ms: starts-on-event=CanTp_MainFunction_Entity, period=0.001
  bsw implementation CanTp_Implementation: programming-language=C, sw-version=0.1.0, ar-release-version=4.10.0, behavior=CanTp/Behavior
package /AUTOSAR_CanTp/BswModuleEntrys
  bsw module entry CanTp_Init: is-reentrant=false, is-synchronous=true, call-type=REGULAR, execution-context=UNSPECIFIED, sw-service-impl-policy=STANDARD, bsw-entry-kind=CONCRETE
    sw service arg Config: category=VALUE, direction=IN, base-type=Native5
  bsw module entry CanTp_MainFunction: is-reentrant=false, is-synchronous=true, call-type=SCHEDULED, execution-context=TASK, sw-service-impl-policy=STANDARD, bsw-entry-kind=CONCRETE
package /AUTOSAR_Com
  bsw module description Com: category=BSW_MODULE, implemented-entrys=[Com_Init, Com_SendSignal, Com_ReceiveSignal, Com_MainFunctionRx_Rx, Com_MainFunctionTx_Tx], module-id=50
    bsw internal behavior Behavior
      bsw schedulable entity Com_MainFunctionRx_Rx_Entity: implemented-entry=Com_MainFunctionRx_Rx
      bsw schedulable entity Com_MainFunctionTx_Tx_Entity: implemented-entry=Com_MainFunctionTx_Tx
      bsw timing event Com_MainFunctionRx_Rx_1ms: starts-on-event=Com_MainFunctionRx_Rx_Entity, period=0.001
      bsw timing event Com_MainFunctionTx_Tx_10ms: starts-on-event=Com_MainFunctionTx_Tx_Entity, period=0.01
  bsw implementation Com_Implementation: programming-language=C, sw-version=0.1.0, ar-release-version=4.10.0, behavior=Com/Behavior
package /AUTOSAR_Com/BswModuleEntrys
  5 x bsw module entry, all with sw-service-impl-policy=STANDARD, bsw-entry-kind=CONCRETE:
    Com_Init: is-reentrant=false, is-synchronous=true, call-type=REGULAR, execution-context=UNSPECIFIED
      sw service arg Config: category=VALUE, direction=IN, base-type=Native6
    Com_SendSignal: is-reentrant=true, is-synchronous=false, call-type=REGULAR, execution-context=TASK
      return type ReturnValue: category=VALUE, direction=OUT, base-type=Native7
      sw service arg SignalId: category=VALUE, direction=IN, base-type=Native8
      sw service arg SignalData: category=VALUE, direction=IN, base-type=Native9
    Com_ReceiveSignal: is-reentrant=true, is-synchronous=true, call-type=REGULAR, execution-context=TASK
      return type ReturnValue: category=VALUE, direction=OUT, base-type=Native7
      sw service arg SignalId: category=VALUE, direction=IN, base-type=Native8
      sw service arg SignalData: category=VALUE, direction=OUT, base-type=Native10
    Com_MainFunctionRx_Rx: is-reentrant=false, is-synchronous=true, call-type=SCHEDULED, execution-context=TASK
    Com_MainFunctionTx_Tx: is-reentrant=false, is-synchronous=true, call-type=SCHEDULED, execution-context=TASK
package /AUTOSAR_Dcm
  bsw module description Dcm: category=BSW_MODULE, module-id=53
    implemented-entrys:
      Dcm_Init
      Dcm_MainFunction
      Dcm_GetSecurityLevel
      Dcm_GetSesCtrlType
      Dcm_ResetToDefaultSession
      Dcm_SetActiveDiagnostic
    provided-mode-groups:
      6 x mode declaration group prototype:
        DcmDiagnosticSessionControl: type=DcmDiagnosticSessionControl
        DcmEcuReset: type=DcmEcuReset
        DcmModeRapidPowerShutDown: type=DcmModeRapidPowerShutDown
        DcmControlDTCSetting: type=DcmControlDTCSetting
        DcmSecurityAccess: type=DcmSecurityAccess
        DcmAuthenticationState_Physical: type=DcmAuthenticationState_Physical
    bsw internal behavior Behavior
      bsw schedulable entity Dcm_MainFunction_Entity: implemented-entry=Dcm_MainFunction
      4 x bsw called entity:
        Dcm_GetSecurityLevel_Entity: implemented-entry=Dcm_GetSecurityLevel
        Dcm_GetSesCtrlType_Entity: implemented-entry=Dcm_GetSesCtrlType
        Dcm_ResetToDefaultSession_Entity: implemented-entry=Dcm_ResetToDefaultSession
        Dcm_SetActiveDiagnostic_Entity: implemented-entry=Dcm_SetActiveDiagnostic
      bsw timing event Dcm_MainFunction_1ms: starts-on-event=Dcm_MainFunction_Entity, period=0.001
  bsw implementation Dcm_Implementation: programming-language=C, sw-version=0.1.0, ar-release-version=4.10.0, behavior=Dcm/Behavior
  mode declaration group DcmDiagnosticSessionControl: category=EXPLICIT_ORDER, initial-mode=DCM_DEFAULT_SESSION, on-transition-value=255
    4 x mode:
      DCM_DEFAULT_SESSION: value=0
      DCM_PROGRAMMING_SESSION: value=1
      DCM_EXTENDED_DIAGNOSTIC_SESSION: value=2
      DCM_SAFETY_SYSTEM_DIAGNOSTIC_SESSION: value=3
  impl type Rte_ModeType_DcmDiagnosticSessionControl: category=VALUE, base-type=Native7, type-emitter=Rte_Dcm_Type.h
  mode declaration group DcmEcuReset: category=EXPLICIT_ORDER, initial-mode=DCM_NONE, on-transition-value=255
    7 x mode:
      DCM_NONE: value=0
      DCM_HARD: value=1
      DCM_KEYONOFF: value=2
      DCM_SOFT: value=3
      DCM_JUMPTOBOOTLOADER: value=4
      DCM_JUMPTOSYSSUPPLIERBOOTLOADER: value=5
      DCM_EXECUTE: value=6
  impl type Rte_ModeType_DcmEcuReset: category=VALUE, base-type=Native7, type-emitter=Rte_Dcm_Type.h
  mode declaration group DcmModeRapidPowerShutDown: category=EXPLICIT_ORDER, initial-mode=DCM_ENABLE_RAPIDPOWERSHUTDOWN, on-transition-value=255
    mode DCM_ENABLE_RAPIDPOWERSHUTDOWN: value=0
    mode DCM_DISABLE_RAPIDPOWERSHUTDOWN: value=1
  impl type Rte_ModeType_DcmModeRapidPowerShutDown: category=VALUE, base-type=Native7, type-emitter=Rte_Dcm_Type.h
  mode declaration group DcmControlDTCSetting: category=EXPLICIT_ORDER, initial-mode=DCM_ENABLEDTCSETTING, on-transition-value=255
    mode DCM_ENABLEDTCSETTING: value=0
    mode DCM_DISABLEDTCSETTING: value=1
  impl type Rte_ModeType_DcmControlDTCSetting: category=VALUE, base-type=Native7, type-emitter=Rte_Dcm_Type.h
  mode declaration group DcmSecurityAccess: category=EXPLICIT_ORDER, initial-mode=DCM_SEC_LEV_LOCKED, on-transition-value=255
    mode DCM_SEC_LEV_LOCKED: value=0
  impl type Rte_ModeType_DcmSecurityAccess: category=VALUE, base-type=Native7, type-emitter=Rte_Dcm_Type.h
  mode declaration group DcmAuthenticationState_Physical: category=EXPLICIT_ORDER, initial-mode=DCM_DEAUTHENTICATED, on-transition-value=255
    mode DCM_DEAUTHENTICATED: value=0
    mode DCM_AUTHENTICATED: value=1
  impl type Rte_ModeType_DcmAuthenticationState_Physical: category=VALUE, base-type=Native7, type-emitter=Rte_Dcm_Type.h
package /AUTOSAR_Dcm/BswModuleEntrys
  6 x bsw module entry, all with is-synchronous=true, sw-service-impl-policy=STANDARD, bsw-entry-kind=CONCRETE:
    Dcm_Init: is-reentrant=false, call-type=REGULAR, execution-context=UNSPECIFIED
      sw service arg Config: category=VALUE, direction=IN, base-type=Native11
    Dcm_MainFunction: is-reentrant=false, call-type=SCHEDULED, execution-context=TASK
    Dcm_GetSecurityLevel: is-reentrant=true, call-type=REGULAR, execution-context=UNSPECIFIED
      return type result: category=VALUE, base-type=Native1
      sw service arg SecLevel: category=VALUE, direction=OUT, base-type=DcmNativeGetSecurityLevel
    Dcm_GetSesCtrlType: is-reentrant=true, call-type=REGULAR, execution-context=UNSPECIFIED
      return type result: category=VALUE, base-type=Native1
      sw service arg SesCtrlType: category=VALUE, direction=OUT, base-type=DcmNativeGetSesCtrlType
    Dcm_ResetToDefaultSession: is-reentrant=true, call-type=REGULAR, execution-context=UNSPECIFIED
      return type result: category=VALUE, base-type=Native1
    Dcm_SetActiveDiagnostic: is-reentrant=true, call-type=REGULAR, execution-context=UNSPECIFIED
      return type result: category=VALUE, base-type=Native1
      sw service arg active: category=VALUE, direction=IN, base-type=DcmNativeSetActiveDiagnostic
package /AUTOSAR_ComM
  bsw module description ComM: category=BSW_MODULE, module-id=12
    implemented-entrys:
      ComM_MainFunction_Host
      ComM_GetCurrentComMode
      ComM_GetCurrentPNCComMode
      ComM_GetMaxComMode
      ComM_GetRequestedComMode
      ComM_RequestComMode
      ComM_BusSM_ModeIndication
    provided-mode-groups:
      mode declaration group prototype UM_HostUser: type=ComMMode
    bsw internal behavior Behavior
      bsw schedulable entity ComM_MainFunction_Host_Entity: implemented-entry=ComM_MainFunction_Host
      6 x bsw called entity:
        ComM_GetCurrentComMode_Entity: implemented-entry=ComM_GetCurrentComMode
        ComM_GetCurrentPNCComMode_Entity: implemented-entry=ComM_GetCurrentPNCComMode
        ComM_GetMaxComMode_Entity: implemented-entry=ComM_GetMaxComMode
        ComM_GetRequestedComMode_Entity: implemented-entry=ComM_GetRequestedComMode
        ComM_RequestComMode_Entity: implemented-entry=ComM_RequestComMode
        ComM_BusSM_ModeIndication_Entity: implemented-entry=ComM_BusSM_ModeIndication, managed-mode-groups=UM_HostUser
      bsw timing event ComM_MainFunction_Host_1ms: starts-on-event=ComM_MainFunction_Host_Entity, period=0.001
  bsw implementation ComM_Implementation: programming-language=C, sw-version=0.1.0, ar-release-version=4.10.0, behavior=ComM/Behavior
package /AUTOSAR_ComM/BswModuleEntrys
  bsw module entry ComM_MainFunction_Host: is-reentrant=false, is-synchronous=true, call-type=SCHEDULED, execution-context=TASK, sw-service-impl-policy=STANDARD, bsw-entry-kind=CONCRETE
  bsw module entry ComM_GetCurrentComMode: is-reentrant=true, is-synchronous=true, call-type=REGULAR, execution-context=TASK, sw-service-impl-policy=STANDARD
    return type result: category=VALUE, base-type=Native1
    sw service arg User: category=VALUE, direction=IN, base-type=ComM_GetCurrentComModeUserNative
    sw service arg ComMode: category=VALUE, direction=OUT, base-type=ComM_GetCurrentComModeComModeNative
  base type ComM_GetCurrentComModeUserNative: category=FIXED_LENGTH, base-type-size=16, base-type-encoding=NONE, native-declaration=ComM_UserHandleType
  base type ComM_GetCurrentComModeComModeNative: category=FIXED_LENGTH, base-type-size=8, base-type-encoding=NONE, native-declaration=ComM_ModeType *
  bsw module entry ComM_GetCurrentPNCComMode: is-reentrant=true, is-synchronous=true, call-type=REGULAR, execution-context=TASK, sw-service-impl-policy=STANDARD
    return type result: category=VALUE, base-type=Native1
    sw service arg User: category=VALUE, direction=IN, base-type=ComM_GetCurrentPNCComModeUserNative
    sw service arg ComMode: category=VALUE, direction=OUT, base-type=ComM_GetCurrentPNCComModeComModeNative
  base type ComM_GetCurrentPNCComModeUserNative: category=FIXED_LENGTH, base-type-size=16, base-type-encoding=NONE, native-declaration=ComM_UserHandleType
  base type ComM_GetCurrentPNCComModeComModeNative: category=FIXED_LENGTH, base-type-size=8, base-type-encoding=NONE, native-declaration=ComM_ModeType *
  bsw module entry ComM_GetMaxComMode: is-reentrant=true, is-synchronous=true, call-type=REGULAR, execution-context=TASK, sw-service-impl-policy=STANDARD
    return type result: category=VALUE, base-type=Native1
    sw service arg User: category=VALUE, direction=IN, base-type=ComM_GetMaxComModeUserNative
    sw service arg ComMode: category=VALUE, direction=OUT, base-type=ComM_GetMaxComModeComModeNative
  base type ComM_GetMaxComModeUserNative: category=FIXED_LENGTH, base-type-size=16, base-type-encoding=NONE, native-declaration=ComM_UserHandleType
  base type ComM_GetMaxComModeComModeNative: category=FIXED_LENGTH, base-type-size=8, base-type-encoding=NONE, native-declaration=ComM_ModeType *
  bsw module entry ComM_GetRequestedComMode: is-reentrant=true, is-synchronous=true, call-type=REGULAR, execution-context=TASK, sw-service-impl-policy=STANDARD
    return type result: category=VALUE, base-type=Native1
    sw service arg User: category=VALUE, direction=IN, base-type=ComM_GetRequestedComModeUserNative
    sw service arg ComMode: category=VALUE, direction=OUT, base-type=ComM_GetRequestedComModeComModeNative
  base type ComM_GetRequestedComModeUserNative: category=FIXED_LENGTH, base-type-size=16, base-type-encoding=NONE, native-declaration=ComM_UserHandleType
  base type ComM_GetRequestedComModeComModeNative: category=FIXED_LENGTH, base-type-size=8, base-type-encoding=NONE, native-declaration=ComM_ModeType *
  bsw module entry ComM_RequestComMode: is-reentrant=true, is-synchronous=true, call-type=REGULAR, execution-context=TASK, sw-service-impl-policy=STANDARD
    return type result: category=VALUE, base-type=Native1
    sw service arg User: category=VALUE, direction=IN, base-type=ComM_RequestComModeUserNative
    sw service arg ComMode: category=VALUE, direction=IN, base-type=ComM_RequestComModeComModeNative
  base type ComM_RequestComModeUserNative: category=FIXED_LENGTH, base-type-size=16, base-type-encoding=NONE, native-declaration=ComM_UserHandleType
  base type ComM_RequestComModeComModeNative: category=FIXED_LENGTH, base-type-size=8, base-type-encoding=NONE, native-declaration=ComM_ModeType
  bsw module entry ComM_BusSM_ModeIndication: is-reentrant=true, is-synchronous=false, call-type=REGULAR, execution-context=UNSPECIFIED, sw-service-impl-policy=STANDARD, bsw-entry-kind=CONCRETE
    sw service arg Channel: category=VALUE, direction=IN, base-type=IndicationChannel
    sw service arg ComMode: category=VALUE, direction=IN, base-type=IndicationComMode
  base type IndicationChannel: category=FIXED_LENGTH, base-type-size=8, base-type-encoding=NONE, native-declaration=NetworkHandleType
  base type IndicationComMode: category=FIXED_LENGTH, base-type-size=8, base-type-encoding=NONE, native-declaration=ComM_ModeType
