AUTOSAR XML (schema 00053)
package /Application
  composition sw component type Pipeline
    5 x component:
      IngressInstance: type=Ingress
      ProcessInstance: type=Process
      ObserveInstance: type=Observe
      DcmService: type=DcmService
      ComMService: type=ComMService
    connect IngressInstance.Value -> ProcessInstance.Value
    connect IngressInstance.Value -> ObserveInstance.Value
    connect ProcessInstance.Result -> ObserveInstance.Result
    connect ProcessInstance.ResultService -> ObserveInstance.ResultService
    connect IngressInstance.ApplicationValue -> DcmService.DataServices_ApplicationValue
