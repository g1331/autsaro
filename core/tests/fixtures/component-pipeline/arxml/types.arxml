AUTOSAR XML (schema 00053)
standard types defined: uint8, uint32
package /Types
  base type Base_uint8: category=FIXED_LENGTH, base-type-size=8, base-type-encoding=NONE, native-declaration=uint8
  base type Base_uint32: category=FIXED_LENGTH, base-type-size=32, base-type-encoding=NONE, native-declaration=uint32
  app type ApplicationUint32: category=VALUE
  impl type Dcm_DataElement_ApplicationValueType: category=ARRAY
    element Byte: array-size=4, array-size-semantics=FIXED-SIZE, implementation-data-type=uint8
  data type mapping set ApplicationTypes: data-type-map{application-data-type=ApplicationUint32, implementation-data-type=uint32}
  sender receiver interface ValueInterface
    data Value: type=ApplicationUint32
  client server interface DataServices_ApplicationValue: is-service=true, service-kind=DIAGNOSTIC-COMMUNICATION-MANAGER
    operation ReadData: possible-error=E_NOT_OK
      arg Data: type=Dcm_DataElement_ApplicationValueType, direction=OUT, server-argument-impl-policy=USE-ARGUMENT-TYPE
    error E_NOT_OK: error-code=1
  11 x base type, all with category=FIXED_LENGTH, base-type-encoding=NONE:
    Host_EcuStatus: base-type-size=32, native-declaration=EcuStatus
    Host_size_t: base-type-size=64, native-declaration=size_t
    Host_uint64_t: base-type-size=64, native-declaration=uint64_t
    Host_uint16_t: base-type-size=16, native-declaration=uint16_t
    Host_uint32_t: base-type-size=32, native-declaration=uint32_t
    Host_CanConfigPointer: base-type-size=64, native-declaration=const Can_ConfigType *
    Host_EcuConfigPointer: base-type-size=64, native-declaration=const EcuConfig *
    Host_DiagnosticConfigPointer: base-type-size=64, native-declaration=const EcuDiagnosticConfig *
    Host_ConstUint8Pointer: base-type-size=64, native-declaration=const uint8_t *
    Host_Uint32Pointer: base-type-size=64, native-declaration=uint32_t *
    Host_Uint8Pointer: base-type-size=64, native-declaration=uint8_t *
  client server interface ScalarService
    operation Transform
      arg Input: type=ApplicationUint32, direction=IN
      arg Output: type=ApplicationUint32, direction=OUT
      arg State: type=ApplicationUint32, direction=INOUT
