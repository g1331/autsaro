AUTOSAR XML (schema 00053)
package /Services
  service sw component type DcmService
    behavior Behavior
      runnable DcmReadData: symbol=DcmService_ReadData
        sync call ReadApplicationValue: operation=ApplicationValue.ReadData
