AUTOSAR XML (schema 00053)
package /Extract
  ecu instance ReferenceEcu
    can communication controller CanController
    can communication connector CanConnector: comm-controller=CanController
  can cluster ReferenceCan: baudrate=500000
    can physical channel Channel: comm-connectors=CanConnector
      frame RxValueFrame: id 0x320, to ReferenceEcu, frame-length=4, can-addressing-mode=STANDARD, can-fd-frame-support=false
        pdu RxValuePdu: length=4
          signal RxValueSignal: start 0, 32 bit, little-endian, system signal RxValueSystemSignal, data-transformations=UnsupportedTransformation, data-type-policy=OVERRIDE, init-value=0, base-type=Base_uint32, transfer-property=PENDING, to ReferenceEcu(timeout 0.03 s)
      frame TxValueFrame: id 0x321, from ReferenceEcu, frame-length=4, can-addressing-mode=STANDARD, can-fd-frame-support=false
        pdu TxValuePdu: length=4
          signal TxValueSignal: start 0, 32 bit, little-endian, system signal TxValueSystemSignal, data-type-policy=OVERRIDE, init-value=0, base-type=Base_uint32, transfer-property=PENDING
      frame DiagRequestFrame: id 0x700, to ReferenceEcu, frame-length=8, can-addressing-mode=STANDARD, can-fd-frame-support=false
        n pdu DiagRequestPdu: length=8
      frame DiagResponseFrame: id 0x708, from ReferenceEcu, frame-length=8, can-addressing-mode=STANDARD, can-fd-frame-support=false
        n pdu DiagResponsePdu: length=8
  system ReferenceExtract: category=ECU_EXTRACT, ecu-extract-version=1.0.0
    system mapping Mapping
      data-mappings:
        communication-direction=IN, data-element=EchoApplication.RootComposition.RxValue.Value, system-signal=RxValueSystemSignal
        communication-direction=OUT, data-element=EchoApplication.RootComposition.TxValue.Value, system-signal=TxValueSystemSignal
      sw-mappings:
        swc to ecu mapping EchoToEcu: component=[RootComposition.EchoApplication, RootComposition.DcmService], ecu-instance=ReferenceEcu
    root-software-compositions:
      root sw composition prototype RootComposition: software-composition=ReferenceComposition
  data transformation set UnsupportedTransformationSet
    data transformation UnsupportedTransformation: transformer-chain=UnsupportedTechnology
    transformation technology UnsupportedTechnology: protocol=ReferenceUnsupported
