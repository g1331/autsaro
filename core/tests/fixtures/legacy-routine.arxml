AUTOSAR XML (schema 00053)
package /Legacy
  pdu Pdu_Live: length=8
    signal ISignal_LiveA: start 0, 32 bit, little-endian
    signal ISignal_LiveB: start 32, 32 bit, little-endian
  n pdu NPdu_DiagRequest: has-dynamic-length=true, length=8
  n pdu NPdu_DiagResponse: has-dynamic-length=true, length=8
  dcm i pdu DcmPdu_DiagRequest: length=256
  dcm i pdu DcmPdu_DiagResponse: length=256
  module config CanTpCfg: definition=CanTp
    CanTpConfig: CanTpMainFunctionPeriod=0.001
      Channel (CanTpChannel)
        Request (CanTpRxNSdu):
          CanTpRxNSduId = 0
          CanTpRxAddressingFormat = CANTP_STANDARD
          CanTpRxPaddingActivation = CANTP_OFF
          CanTpRxTaType = CANTP_PHYSICAL
          CanTpBs = 0
          CanTpSTmin = 0
          CanTpRxWftMax = 0
          CanTpNcr = 0.2
          CanTpRxNSduRef = DcmPdu_DiagRequest
          RequestNPdu (CanTpRxNPdu): CanTpRxNPduId=0, CanTpRxNPduRef=NPdu_DiagRequest
          ResponseFc (CanTpTxFcNPdu): CanTpTxFcNPduConfirmationPduId=1, CanTpTxFcNPduRef=NPdu_DiagResponse
        Response (CanTpTxNSdu):
          CanTpTxNSduId = 0
          CanTpTxAddressingFormat = CANTP_STANDARD
          CanTpTxPaddingActivation = CANTP_OFF
          CanTpTxTaType = CANTP_PHYSICAL
          CanTpTc = false
          CanTpNas = 0.2
          CanTpNbs = 0.2
          CanTpTxNSduRef = DcmPdu_DiagResponse
          ResponseNPdu (CanTpTxNPdu): CanTpTxNPduConfirmationPduId=0, CanTpTxNPduRef=NPdu_DiagResponse
          RequestFc (CanTpRxFcNPdu): CanTpRxFcNPduId=1, CanTpRxFcNPduRef=NPdu_DiagRequest
    CanTpGeneral:
      CanTpChangeParameterApi = false
      CanTpDevErrorDetect = false
      CanTpEnableSecurityEventReporting = false
      CanTpReadParameterApi = false
      CanTpVersionInfoApi = false
      CanTpPaddingByte = 0
  module config DcmCfg: definition=Dcm
    DcmConfigSet
      DcmDsd
        Services (DcmDsdServiceTable): DcmDsdSidTabId=0
          5 x DcmDsdService, all with DcmDsdServiceUsed=true:
            SessionControl: DcmDsdSidTabServiceId=16, DcmDsdSidTabSubfuncAvail=true
            ReadDataByIdentifier: DcmDsdSidTabServiceId=34, DcmDsdSidTabSubfuncAvail=false
            TesterPresent: DcmDsdSidTabServiceId=62, DcmDsdSidTabSubfuncAvail=true
            WriteDataByIdentifier: DcmDsdSidTabServiceId=46, DcmDsdSidTabSubfuncAvail=false
            RoutineControl: DcmDsdSidTabServiceId=49, DcmDsdSidTabSubfuncAvail=true
      DcmDsl
        Buffer (DcmDslBuffer): DcmDslBufferSize=256
        DiagResp (DcmDslDiagResp): DcmDslDiagRespOnSecondDeclinedRequest=true
        Protocol (DcmDslProtocol)
          UdsCan (DcmDslProtocolRow):
            DcmDslProtocolPriority = 0
            DcmDslProtocolRowUsed = true
            DcmDslProtocolType = DCM_UDS_ON_CAN
            DcmSendRespPendOnRestart = false
            DcmTimStrP2ServerAdjust = 0
            DcmTimStrP2StarServerAdjust = 0
            DcmDslProtocolRxBufferRef = Buffer
            DcmDslProtocolTxBufferRef = Buffer
            DcmDslProtocolSIDTable = Services
            Main (DcmDslMainConnection): DcmDslProtocolRxConnectionId=0
              Request (DcmDslProtocolRx): DcmDslProtocolRxAddrType=DCM_PHYSICAL_TYPE, DcmDslProtocolRxPduId=0, DcmDslProtocolRxPduRef=DcmPdu_DiagRequest
              Response (DcmDslProtocolTx): DcmDslTxConfirmationPduId=0, DcmDslProtocolTxPduRef=DcmPdu_DiagResponse
      DcmDsp: DcmDspDataDefaultEndianness=BIG_ENDIAN, DcmDspEnableObdMirror=false
        Did (DcmDspDid): DcmDspDidIdentifier=4660, DcmDspDidSize=8, DcmDspDidUsed=true, DcmDspDidUsePort=USE_DATA_ELEMENT_SPECIFIC_INTERFACES, DcmDspDidInfoRef=DidInfo
          Signal_0 (DcmDspDidSignal): DcmDspDidByteOffset=0, DcmDspDidDataRef=Data_0
          Signal_1 (DcmDspDidSignal): DcmDspDidByteOffset=4, DcmDspDidDataRef=Data_1
        DidInfo (DcmDspDidInfo): DcmDspDidDynamicallyDefined=false
          Read (DcmDspDidRead): DcmDspDidReadSessionRef=Extended
          Write (DcmDspDidWrite): DcmDspDidWriteSessionRef=Extended
        Data_0 (DcmDspData):
          DcmDspDataType = UINT32
          DcmDspDataUsePort = USE_DATA_SYNCH_FNC
          DcmDspDataEndianness = BIG_ENDIAN
          DcmDspDataReadFnc = Ecu_DcmRead_0
          DcmDspDataByteSize = 4
          DcmDspDataWriteFnc = Ecu_DcmWrite_0
        Data_1 (DcmDspData):
          DcmDspDataType = UINT32
          DcmDspDataUsePort = USE_DATA_SYNCH_FNC
          DcmDspDataEndianness = BIG_ENDIAN
          DcmDspDataReadFnc = Ecu_DcmRead_1
          DcmDspDataByteSize = 4
          DcmDspDataWriteFnc = Ecu_DcmWrite_1
        Sessions (DcmDspSession)
          Default (DcmDspSessionRow): DcmDspSessionLevel=1, DcmDspSessionForBoot=DCM_NO_BOOT, DcmDspSessionP2ServerMax=0.050, DcmDspSessionP2StarServerMax=5
          Extended (DcmDspSessionRow): DcmDspSessionLevel=3, DcmDspSessionForBoot=DCM_NO_BOOT, DcmDspSessionP2ServerMax=0.050, DcmDspSessionP2StarServerMax=5
        ResetRoutineAuthorization (DcmDspCommonAuthorization): DcmDspCommonAuthorizationSessionRef=Extended
        ResetDid (DcmDspRoutine): DcmDspRoutineIdentifier=61441, DcmDspRoutineUsed=true, DcmDspRoutineUsePort=false, DcmDspRoutineFncSignature=ROUTINE_FNC_NORMAL
          Start (DcmDspStartRoutine): DcmDspStartRoutineFnc=Ecu_DcmRestoreDid, DcmDspStartRoutineCommonAuthorizationRef=ResetRoutineAuthorization
      PageBuffer (DcmPageBufferCfg): DcmPagedBufferEnabled=false
    DcmGeneral:
      DcmDevErrorDetect = false
      DcmEnableSecurityEventReporting = false
      DcmRespondAllRequest = false
      DcmVersionInfoApi = false
      DcmTaskTime = 0.001
      DcmS3ServerTimeoutOverwrite = 5
  module config ComCfg: definition=Com
    ComConfig
      Pdu_Live (ComIPdu): ComIPduDirection=SEND, ComIPduHandleId=0, ComPduIdRef=Pdu_Live, ComIPduSignalRef=LiveA, ComIPduSignalRef=LiveB
        Tx (ComTxIPdu)
          TrueMode (ComTxModeTrue)
            Mode (ComTxMode): ComTxModeMode=PERIODIC, ComTxModeTimePeriod=0.1
      LiveA (ComSignal): ComBitPosition=0, ComBitSize=32, ComHandleId=0, ComSignalEndianness=LITTLE_ENDIAN, ComSignalInitValue=1, ComSignalType=UINT32
      LiveB (ComSignal): ComBitPosition=32, ComBitSize=32, ComHandleId=1, ComSignalEndianness=LITTLE_ENDIAN, ComSignalInitValue=2, ComSignalType=UINT32
  module config CanIfCfg: definition=CanIf
    CanIfInitCfg
      Can_Live (CanIfTxPduCfg): CanIfTxPduCanId=801, CanIfTxPduId=0, CanIfTxPduCanIdType=STANDARD_CAN, CanIfTxPduRef=Pdu_Live
      Can_DiagRequest (CanIfRxPduCfg):
        CanIfRxPduCanId = 1792
        CanIfRxPduId = 1
        CanIfRxPduDataLength = 8
        CanIfRxPduCanIdType = STANDARD_NO_FD_CAN
        CanIfRxPduDataLengthCheck = false
        CanIfRxPduRef = NPdu_DiagRequest
      Can_DiagResponse (CanIfTxPduCfg): CanIfTxPduCanId=1800, CanIfTxPduId=1, CanIfTxPduCanIdType=STANDARD_CAN, CanIfTxPduRef=NPdu_DiagResponse
