AUTOSAR XML (schema 00053)
package /Acceptance
  documentation PreservedType
