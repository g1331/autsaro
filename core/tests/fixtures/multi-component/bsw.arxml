AUTOSAR XML (schema 00053)
package /Bsw
  4 x bsw module entry, all with is-reentrant=false, is-synchronous=true:
    Can_Init: call-type=REGULAR, execution-context=UNSPECIFIED
      sw service arg config: category=VALUE, direction=IN, base-type=Host_CanConfigPointer
    Can_MainFunction_Wakeup: call-type=SCHEDULED, execution-context=TASK
    Can_MainFunction_Read: call-type=REGULAR, execution-context=TASK
    Can_MainFunction_Write: call-type=REGULAR, execution-context=TASK
  bsw module description Can: implemented-entrys=[Can_Init, Can_MainFunction_Wakeup, Can_MainFunction_Read, Can_MainFunction_Write]
    bsw internal behavior Behavior
      bsw schedulable entity Can_MainFunction_Wakeup_Entity: implemented-entry=Can_MainFunction_Wakeup
      bsw timing event Can_MainFunction_Wakeup_1ms: starts-on-event=Can_MainFunction_Wakeup_Entity, period=0.001
  bsw implementation Can_Implementation: programming-language=C, sw-version=0.1.0, ar-release-version=4.10.0, behavior=Can/Behavior
  bsw module entry CanIf_Init: is-reentrant=false, is-synchronous=true, call-type=REGULAR, execution-context=UNSPECIFIED
    sw service arg config: category=VALUE, direction=IN, base-type=Host_EcuConfigPointer
  bsw module entry CanIf_Transmit: is-reentrant=false, is-synchronous=true, call-type=REGULAR, execution-context=TASK
    return type ReturnValue: category=VALUE, direction=OUT, base-type=Host_EcuStatus
    sw service arg frame_index: category=VALUE, direction=IN, base-type=Host_size_t
    sw service arg data: category=VALUE, direction=IN, base-type=Host_ConstUint8Pointer
  bsw module description CanIf: implemented-entrys=[CanIf_Init, CanIf_Transmit]
    bsw internal behavior Behavior
  bsw implementation CanIf_Implementation: programming-language=C, sw-version=0.1.0, ar-release-version=4.10.0, behavior=CanIf/Behavior
  bsw module entry PduR_Init: is-reentrant=false, is-synchronous=true, call-type=REGULAR, execution-context=UNSPECIFIED
    sw service arg config: category=VALUE, direction=IN, base-type=Host_EcuConfigPointer
  bsw module entry PduR_Transmit: is-reentrant=false, is-synchronous=true, call-type=REGULAR, execution-context=TASK
    return type ReturnValue: category=VALUE, direction=OUT, base-type=Host_EcuStatus
    sw service arg frame_index: category=VALUE, direction=IN, base-type=Host_size_t
    sw service arg data: category=VALUE, direction=IN, base-type=Host_ConstUint8Pointer
  bsw module description PduR: implemented-entrys=[PduR_Init, PduR_Transmit]
    bsw internal behavior Behavior
  bsw implementation PduR_Implementation: programming-language=C, sw-version=0.1.0, ar-release-version=4.10.0, behavior=PduR/Behavior
  bsw module entry CanTp_Init: is-reentrant=false, is-synchronous=true, call-type=REGULAR, execution-context=UNSPECIFIED
    sw service arg config: category=VALUE, direction=IN, base-type=Host_DiagnosticConfigPointer
  bsw module entry CanTp_AdvanceTime: is-reentrant=false, is-synchronous=true, call-type=SCHEDULED, execution-context=TASK
    return type ReturnValue: category=VALUE, direction=OUT, base-type=Host_EcuStatus
    sw service arg now_ms: category=VALUE, direction=IN, base-type=Host_uint64_t
  bsw module description CanTp: implemented-entrys=[CanTp_Init, CanTp_AdvanceTime]
    bsw internal behavior Behavior
      bsw schedulable entity CanTp_AdvanceTime_Entity: implemented-entry=CanTp_AdvanceTime
      bsw timing event CanTp_AdvanceTime_1ms: starts-on-event=CanTp_AdvanceTime_Entity, period=0.001
  bsw implementation CanTp_Implementation: programming-language=C, sw-version=0.1.0, ar-release-version=4.10.0, behavior=CanTp/Behavior
  5 x bsw module entry, all with is-reentrant=false, is-synchronous=true:
    Com_Init: call-type=REGULAR, execution-context=UNSPECIFIED
      sw service arg config: category=VALUE, direction=IN, base-type=Host_EcuConfigPointer
    Com_SetSignal: call-type=REGULAR, execution-context=TASK
      return type ReturnValue: category=VALUE, direction=OUT, base-type=Host_EcuStatus
      sw service arg id: category=VALUE, direction=IN, base-type=Host_uint16_t
      sw service arg value: category=VALUE, direction=IN, base-type=Host_uint32_t
    Com_GetSignal: call-type=REGULAR, execution-context=TASK
      return type ReturnValue: category=VALUE, direction=OUT, base-type=Host_EcuStatus
      sw service arg id: category=VALUE, direction=IN, base-type=Host_uint16_t
      sw service arg value: category=VALUE, direction=OUT, base-type=Host_Uint32Pointer
      sw service arg valid: category=VALUE, direction=OUT, base-type=Host_Uint8Pointer
    Com_AdvanceTime: call-type=SCHEDULED, execution-context=TASK
      return type ReturnValue: category=VALUE, direction=OUT, base-type=Host_EcuStatus
      sw service arg now_ms: category=VALUE, direction=IN, base-type=Host_uint64_t
    Com_TriggerTransmit: call-type=SCHEDULED, execution-context=TASK
      return type ReturnValue: category=VALUE, direction=OUT, base-type=Host_EcuStatus
      sw service arg frame_index: category=VALUE, direction=IN, base-type=Host_size_t
  bsw module description Com: implemented-entrys=[Com_Init, Com_SetSignal, Com_GetSignal, Com_AdvanceTime, Com_TriggerTransmit]
    bsw internal behavior Behavior
      bsw schedulable entity Com_AdvanceTime_Entity: implemented-entry=Com_AdvanceTime
      bsw schedulable entity Com_TriggerTransmit_Entity: implemented-entry=Com_TriggerTransmit
      bsw timing event Com_AdvanceTime_1ms: starts-on-event=Com_AdvanceTime_Entity, period=0.001
      bsw timing event Com_TriggerTransmit_10ms: starts-on-event=Com_TriggerTransmit_Entity, period=0.01
  bsw implementation Com_Implementation: programming-language=C, sw-version=0.1.0, ar-release-version=4.10.0, behavior=Com/Behavior
  bsw module entry Dcm_Init: is-reentrant=false, is-synchronous=true, call-type=REGULAR, execution-context=UNSPECIFIED
    sw service arg config: category=VALUE, direction=IN, base-type=Host_DiagnosticConfigPointer
  bsw module entry Dcm_AdvanceTime: is-reentrant=false, is-synchronous=true, call-type=SCHEDULED, execution-context=TASK
    sw service arg now_ms: category=VALUE, direction=IN, base-type=Host_uint64_t
  bsw module description Dcm: implemented-entrys=[Dcm_Init, Dcm_AdvanceTime]
    bsw internal behavior Behavior
      bsw schedulable entity Dcm_AdvanceTime_Entity: implemented-entry=Dcm_AdvanceTime
      bsw timing event Dcm_AdvanceTime_1ms: starts-on-event=Dcm_AdvanceTime_Entity, period=0.001
  bsw implementation Dcm_Implementation: programming-language=C, sw-version=0.1.0, ar-release-version=4.10.0, behavior=Dcm/Behavior
