AUTOSAR XML (schema 00053)
package /LegacySignal
  pdu Pdu_Command: length=2
    signal ISignal_SendCount: start 3, 8 bit, little-endian
  pdu Pdu_Reply: length=2
    signal ISignal_RecvStatus: start 0, 8 bit, little-endian
  module config ComCfg: definition=Com
    ComConfig
      Pdu_Command (ComIPdu): ComIPduDirection=SEND, ComIPduHandleId=0, ComPduIdRef=Pdu_Command, ComIPduSignalRef=SendCount
        Tx (ComTxIPdu)
          TrueMode (ComTxModeTrue)
            Mode (ComTxMode): ComTxModeMode=PERIODIC, ComTxModeTimePeriod=0.010
      Pdu_Reply (ComIPdu): ComIPduDirection=RECEIVE, ComIPduHandleId=1, ComPduIdRef=Pdu_Reply, ComIPduSignalRef=RecvStatus
      RecvStatus (ComSignal): ComBitPosition=0, ComBitSize=8, ComHandleId=0, ComSignalEndianness=LITTLE_ENDIAN, ComSignalInitValue=0, ComSignalType=UINT8, ComTimeout=0.050
      SendCount (ComSignal): ComBitPosition=3, ComBitSize=8, ComHandleId=1, ComSignalEndianness=LITTLE_ENDIAN, ComSignalInitValue=5, ComSignalType=UINT8
  module config CanIfCfg: definition=CanIf
    CanIfInitCfg
      Can_Command (CanIfTxPduCfg): CanIfTxPduCanId=801, CanIfTxPduId=0, CanIfTxPduCanIdType=STANDARD_CAN, CanIfTxPduRef=Pdu_Command
      Can_Reply (CanIfRxPduCfg): CanIfRxPduCanId=1110, CanIfRxPduId=1, CanIfRxPduDataLength=2, CanIfRxPduRef=Pdu_Reply
