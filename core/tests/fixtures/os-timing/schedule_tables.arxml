AUTOSAR XML (schema 00053)
package /Configuration
  sw addr method CODE: section-type=CODE
  module config Os: ecuc-def-edition=4.10.0, implementation-config-variant=VARIANT-PRE-COMPILE, post-build-variant-used=false
    OSDEFAULTAPPMODE (OsAppMode)
    OperatingSystem (OsOS):
      OsStatus = EXTENDED
      OsScalabilityClass = SC1
      OsUseResScheduler = false
      OsUseGetServiceId = true
      OsUseParameterAccess = true
      OsLockTrustedFunctionCall = true
      OsStackMonitoring = true
      OsUseArti = true
      Hooks (OsHooks): OsStartupHook=true, OsShutdownHook=true, OsErrorHook=true, OsPreTaskHook=true, OsPostTaskHook=true, OsProtectionHook=false
    Task_Ecu (OsTask):
      OsTaskActivation = 1
      OsTaskPriority = 1
      OsTaskSchedule = FULL
      OsMemoryMappingCodeLocationRef = CODE
      OsTaskEventRef = Ev_Work
      OsTaskEventRef = Ev_App
      OsTaskEventRef = Ev_IO
      Autostart (OsTaskAutostart): OsTaskAppModeRef=OSDEFAULTAPPMODE
    3 x OsEvent:
      Ev_Work: OsEventMask=1
      Ev_App: OsEventMask=2
      Ev_IO: OsEventMask=4
    SystemCounter (OsCounter): OsCounterMaxAllowedValue=65535, OsCounterMinCycle=1, OsCounterTicksPerBase=1, OsCounterType=SOFTWARE, OsSecondsPerTick=0.001
    Table_Work (OsScheduleTable): OsScheduleTableDuration=1, OsScheduleTableRepeating=true, OsScheduleTableCounterRef=SystemCounter
      Autostart (OsScheduleTableAutostart): OsScheduleTableAutostartType=RELATIVE, OsScheduleTableStartValue=1, OsScheduleTableAppModeRef=OSDEFAULTAPPMODE
      Sync (OsScheduleTableSync): OsScheduleTblSyncStrategy=NONE
      Point (OsScheduleTableExpiryPoint): OsScheduleTblExpPointOffset=0
        SetEvent (OsScheduleTableEventSetting): OsScheduleTableSetEventTaskRef=Task_Ecu, OsScheduleTableSetEventRef=Ev_Work
    Table_App (OsScheduleTable): OsScheduleTableDuration=10, OsScheduleTableRepeating=true, OsScheduleTableCounterRef=SystemCounter
      Autostart (OsScheduleTableAutostart): OsScheduleTableAutostartType=RELATIVE, OsScheduleTableStartValue=10, OsScheduleTableAppModeRef=OSDEFAULTAPPMODE
      Sync (OsScheduleTableSync): OsScheduleTblSyncStrategy=NONE
      Point (OsScheduleTableExpiryPoint): OsScheduleTblExpPointOffset=0
        SetEvent (OsScheduleTableEventSetting): OsScheduleTableSetEventTaskRef=Task_Ecu, OsScheduleTableSetEventRef=Ev_App
  module config Rte: ecuc-def-edition=4.10.0, implementation-config-variant=VARIANT-PRE-COMPILE, post-build-variant-used=false
    Generation (RteGeneration):
      RteDevErrorDetect = false
      RteDevErrorDetectUninit = false
      RteInExclusiveAreaCheckEnabled = false
      RteMeasurementSupport = false
      RteValueRangeCheckEnabled = false
      RteVfbTraceAnonymousClientEnabled = false
      RteVfbTraceEnabled = false
      RteCodeVendorId = 0
      RteBypassSupport = NONE
      RteCalibrationSupport = NONE
      RteGenerationMode = COMPATIBILITY_MODE
      RteOptimizationMode = RUNTIME
    BswGeneral (RteBswGeneral): RteSchMVersionInfoApi=false
    InitializeINIT (RteInitializationBehavior): RteInitializationStrategy=RTE_INITIALIZATION_STRATEGY_AT_DATA_DECLARATION, RteSectionInitializationPolicy=INIT
    InitializeCLEARED (RteInitializationBehavior): RteInitializationStrategy=RTE_INITIALIZATION_STRATEGY_NONE, RteSectionInitializationPolicy=CLEARED
    EchoApplication (RteSwComponentInstance): RteSoftwareComponentInstanceRef=EchoApplication
      Periodic10ms (RteEventToTaskMapping): RtePositionInTask=4, RteEventRef=Periodic10ms, RteMappedToTaskRef=Task_Ecu, RteUsedOsSchTblExpiryPointRef=Table_App/Point, RteUsedOsEventRef=Ev_App
      ReadApplicationValue (RteEventToTaskMapping): RteEventRef=ReadApplicationValue
    4 x RteBswModuleInstance:
      Can: RteBswImplementationRef=Can_Implementation
        Work1ms (RteBswEventToTaskMapping):
          RteBswPositionInTask = 1
          RteBswEventRef = Can_MainFunction_Wakeup_1ms
          RteBswMappedToTaskRef = Task_Ecu
          RteBswUsedOsSchTblExpiryPointRef = Table_Work/Point
          RteBswUsedOsEventRef = Ev_Work
      CanTp: RteBswImplementationRef=CanTp_Implementation
        Work1ms (RteBswEventToTaskMapping):
          RteBswPositionInTask = 2
          RteBswEventRef = CanTp_AdvanceTime_1ms
          RteBswMappedToTaskRef = Task_Ecu
          RteBswUsedOsSchTblExpiryPointRef = Table_Work/Point
          RteBswUsedOsEventRef = Ev_Work
      Com: RteBswImplementationRef=Com_Implementation
        Work1ms (RteBswEventToTaskMapping):
          RteBswPositionInTask = 3
          RteBswEventRef = Com_AdvanceTime_1ms
          RteBswMappedToTaskRef = Task_Ecu
          RteBswUsedOsSchTblExpiryPointRef = Table_Work/Point
          RteBswUsedOsEventRef = Ev_Work
        Transmit10ms (RteBswEventToTaskMapping):
          RteBswPositionInTask = 5
          RteBswEventRef = Com_TriggerTransmit_10ms
          RteBswMappedToTaskRef = Task_Ecu
          RteBswUsedOsSchTblExpiryPointRef = Table_App/Point
          RteBswUsedOsEventRef = Ev_App
      Dcm: RteBswImplementationRef=Dcm_Implementation
        Work1ms (RteBswEventToTaskMapping):
          RteBswPositionInTask = 6
          RteBswEventRef = Dcm_AdvanceTime_1ms
          RteBswMappedToTaskRef = Task_Ecu
          RteBswUsedOsSchTblExpiryPointRef = Table_Work/Point
          RteBswUsedOsEventRef = Ev_Work
  module config EcuC: ecuc-def-edition=4.10.0, implementation-config-variant=VARIANT-PRE-COMPILE, post-build-variant-used=false
    Config (EcucConfigSet)
      Pdus (EcucPduCollection)
        6 x Pdu:
          RxValuePdu: PduLength=4
          TxValuePdu: PduLength=4
          DiagRequestPdu: PduLength=8
          DiagResponsePdu: PduLength=8
          DiagRequestSdu: PduLength=64
          DiagResponseSdu: PduLength=64
  module config Com: ecuc-def-edition=4.10.0, implementation-config-variant=VARIANT-PRE-COMPILE, post-build-variant-used=false
    Config (ComConfig)
      RxValue (ComSignal):
        ComBitPosition = 0
        ComBitSize = 32
        ComSignalType = UINT32
        ComSignalEndianness = LITTLE_ENDIAN
        ComSignalInitValue = 0
        ComTransferProperty = PENDING
        ComTimeout = 0.03
        ComFirstTimeout = 0
        ComRxDataTimeoutAction = NONE
        ComSystemTemplateSystemSignalRef = RxValueMap
      RxValuePdu (ComIPdu): ComIPduDirection=RECEIVE, ComIPduSignalRef=Config/RxValue, ComPduIdRef=Pdus/RxValuePdu
      TxValue (ComSignal):
        ComBitPosition = 0
        ComBitSize = 32
        ComSignalType = UINT32
        ComSignalEndianness = LITTLE_ENDIAN
        ComSignalInitValue = 0
        ComTransferProperty = PENDING
        ComSystemTemplateSystemSignalRef = TxValueMap
      TxValuePdu (ComIPdu): ComIPduDirection=SEND, ComIPduSignalRef=Config/TxValue, ComPduIdRef=Pdus/TxValuePdu
        Transmit (ComTxIPdu)
          ModeTrue (ComTxModeTrue)
            Periodic (ComTxMode): ComTxModeMode=PERIODIC, ComTxModeTimePeriod=0.01
  module config Dcm: ecuc-def-edition=4.10.0, implementation-config-variant=VARIANT-PRE-COMPILE, post-build-variant-used=false
    Config (DcmConfigSet)
      Dsp (DcmDsp): DcmDspMaxDidToRead=2
        ApplicationValue (DcmDspData):
          DcmDspDataUsePort = USE_DATA_SYNCH_CLIENT_SERVER
          DcmDspDataType = UINT8_N
          DcmDspDataByteSize = 4
          DcmDspDataEndianness = opaque
          DcmDspDataConditionCheckReadFncUsed = false
          DcmDspDataInfoRef = ApplicationValueInfo
        ApplicationValueInfo (DcmDspDataInfo): DcmDspDataScalingInfoSize=0
        ApplicationDid (DcmDspDid): DcmDspDidIdentifier=4660, DcmDspDidInfoRef=ApplicationDidInfo
          Value (DcmDspDidSignal): DcmDspDidByteOffset=0, DcmDspDidDataRef=ApplicationValue
        ApplicationDidInfo (DcmDspDidInfo): DcmDspDidDynamicallyDefined=false
          Read (DcmDspDidRead): DcmDspDidReadSessionRef=Sessions/Default, DcmDspDidReadSessionRef=Sessions/Extended
        Sessions (DcmDspSession)
          Default (DcmDspSessionRow): DcmDspSessionLevel=1, DcmDspSessionForBoot=DCM_NO_BOOT, DcmDspSessionP2ServerMax=0.05, DcmDspSessionP2StarServerMax=5
          Extended (DcmDspSessionRow): DcmDspSessionLevel=3, DcmDspSessionForBoot=DCM_NO_BOOT, DcmDspSessionP2ServerMax=0.05, DcmDspSessionP2StarServerMax=5
      Dsl (DcmDsl)
        RxBuffer (DcmDslBuffer): DcmDslBufferSize=64
        TxBuffer (DcmDslBuffer): DcmDslBufferSize=64
        Protocols (DcmDslProtocol)
          UdsOnCan (DcmDslProtocolRow):
            DcmDslProtocolPriority = 0
            DcmDslProtocolRowUsed = true
            DcmDslProtocolType = DCM_UDS_ON_CAN
            DcmSendRespPendOnRestart = false
            DcmTimStrP2ServerAdjust = 0
            DcmTimStrP2StarServerAdjust = 0
            DcmDslProtocolRxBufferRef = RxBuffer
            DcmDslProtocolTxBufferRef = TxBuffer
            DcmDslProtocolSIDTable = Services
            Connection (DcmDslConnection)
              Physical (DcmDslMainConnection): DcmDslProtocolRxConnectionId=0
                Receive (DcmDslProtocolRx): DcmDslProtocolRxAddrType=DCM_PHYSICAL_TYPE, DcmDslProtocolRxPduId=0, DcmDslProtocolRxPduRef=DiagRequestSdu
                Transmit (DcmDslProtocolTx): DcmDslTxConfirmationPduId=0, DcmDslProtocolTxPduRef=DiagResponseSdu
      Dsd (DcmDsd)
        Services (DcmDsdServiceTable): DcmDsdSidTabId=0
          3 x DcmDsdService, all with DcmDsdServiceUsed=true:
            SessionControl: DcmDsdSidTabServiceId=16, DcmDsdSidTabSubfuncAvail=true
              Default (DcmDsdSubService): DcmDsdSubServiceId=1, DcmDsdSubServiceUsed=true
              Extended (DcmDsdSubService): DcmDsdSubServiceId=3, DcmDsdSubServiceUsed=true
            ReadDataByIdentifier: DcmDsdSidTabServiceId=34, DcmDsdSidTabSubfuncAvail=false
            TesterPresent: DcmDsdSidTabServiceId=62, DcmDsdSidTabSubfuncAvail=true
              Present (DcmDsdSubService): DcmDsdSubServiceId=0, DcmDsdSubServiceUsed=true
    General (DcmGeneral): DcmTaskTime=0.001
  module config Can: ecuc-def-edition=4.10.0, implementation-config-variant=VARIANT-PRE-COMPILE, post-build-variant-used=false
    Config (CanConfigSet)
      Controller (CanController):
        CanControllerId = 0
        CanControllerActivation = true
        CanRxProcessing = POLLING
        CanTxProcessing = POLLING
        CanBusoffProcessing = POLLING
        CanWakeupProcessing = POLLING
        CanWakeupSupport = false
        CanHwPnSupport = false
        CanControllerDefaultBaudrate = Baudrate
        Baudrate (CanControllerBaudrateConfig): CanControllerBaudRate=500
      Receive (CanHardwareObject): CanHandleType=BASIC, CanHwObjectCount=1, CanIdType=STANDARD, CanObjectId=0, CanObjectType=RECEIVE, CanControllerRef=Config/Controller
      Transmit (CanHardwareObject): CanHandleType=BASIC, CanHwObjectCount=1, CanIdType=STANDARD, CanObjectId=1, CanObjectType=TRANSMIT, CanControllerRef=Config/Controller
  module config CanIf: ecuc-def-edition=4.10.0, implementation-config-variant=VARIANT-PRE-COMPILE, post-build-variant-used=false
    Config (CanIfInitCfg)
      Handles (CanIfInitHohCfg)
        Receive (CanIfHrhCfg): CanIfHrhSoftwareFilter=true, CanIfHrhCanCtrlIdRef=Controller/Controller, CanIfHrhIdSymRef=Config/Receive
        Transmit (CanIfHthCfg): CanIfHthCanCtrlIdRef=Controller/Controller, CanIfHthIdSymRef=Config/Transmit
      TransmitBuffer (CanIfBufferCfg): CanIfBufferSize=0, CanIfBufferHthRef=Handles/Transmit
      RxValue (CanIfRxPduCfg):
        CanIfRxPduCanId = 800
        CanIfRxPduCanIdType = STANDARD_NO_FD_CAN
        CanIfRxPduId = 0
        CanIfRxPduReadNotifyStatus = false
        CanIfRxPduDataLength = 4
        CanIfRxPduDataLengthCheck = true
        CanIfRxPduReadData = false
        CanIfRxPduRef = Pdus/RxValuePdu
        CanIfRxPduHrhIdRef = Handles/Receive
      TxValue (CanIfTxPduCfg):
        CanIfTxPduCanId = 801
        CanIfTxPduCanIdType = STANDARD_CAN
        CanIfTxPduId = 0
        CanIfTxPduReadNotifyStatus = false
        CanIfTxPduType = STATIC
        CanIfTxPduTruncation = false
        CanIfTxPduRef = Pdus/TxValuePdu
        CanIfTxPduBufferRef = TransmitBuffer
      DiagRequest (CanIfRxPduCfg):
        CanIfRxPduCanId = 1792
        CanIfRxPduCanIdType = STANDARD_NO_FD_CAN
        CanIfRxPduId = 1
        CanIfRxPduReadNotifyStatus = false
        CanIfRxPduDataLength = 8
        CanIfRxPduDataLengthCheck = true
        CanIfRxPduReadData = false
        CanIfRxPduRef = DiagRequestPdu
        CanIfRxPduHrhIdRef = Handles/Receive
      DiagResponse (CanIfTxPduCfg):
        CanIfTxPduCanId = 1800
        CanIfTxPduCanIdType = STANDARD_CAN
        CanIfTxPduId = 1
        CanIfTxPduReadNotifyStatus = false
        CanIfTxPduType = STATIC
        CanIfTxPduTruncation = false
        CanIfTxPduRef = DiagResponsePdu
        CanIfTxPduBufferRef = TransmitBuffer
    Controller (CanIfCtrlDrvCfg)
      Controller (CanIfCtrlCfg): CanIfCtrlId=0, CanIfCtrlCanCtrlRef=Config/Controller
  module config CanTp: ecuc-def-edition=4.10.0, implementation-config-variant=VARIANT-PRE-COMPILE, post-build-variant-used=false
    Config (CanTpConfig): CanTpMainFunctionPeriod=0.001
      PhysicalChannel (CanTpChannel)
        DiagRequest (CanTpRxNSdu):
          CanTpRxAddressingFormat = CANTP_STANDARD
          CanTpRxNSduId = 0
          CanTpRxPaddingActivation = CANTP_ON
          CanTpRxTaType = CANTP_PHYSICAL
          CanTpNar = 0.2
          CanTpNbr = 0.2
          CanTpNcr = 0.2
          CanTpBs = 0
          CanTpSTmin = 0
          CanTpRxWftMax = 0
          CanTpRxNSduRef = DiagRequestSdu
          Frame (CanTpRxNPdu): CanTpRxNPduId=0, CanTpRxNPduRef=DiagRequestPdu
          FlowControl (CanTpTxFcNPdu): CanTpTxFcNPduConfirmationPduId=0, CanTpTxFcNPduRef=DiagResponsePdu
        DiagResponse (CanTpTxNSdu):
          CanTpTxAddressingFormat = CANTP_STANDARD
          CanTpTxNSduId = 0
          CanTpTxPaddingActivation = CANTP_ON
          CanTpTxTaType = CANTP_PHYSICAL
          CanTpNas = 0.2
          CanTpNbs = 0.2
          CanTpNcs = 0.2
          CanTpTc = false
          CanTpTxNSduRef = DiagResponseSdu
          Frame (CanTpTxNPdu): CanTpTxNPduConfirmationPduId=0, CanTpTxNPduRef=DiagResponsePdu
          FlowControl (CanTpRxFcNPdu): CanTpRxFcNPduId=0, CanTpRxFcNPduRef=DiagRequestPdu
    General (CanTpGeneral): CanTpPaddingByte=0
  module config PduR: ecuc-def-edition=4.10.0, implementation-config-variant=VARIANT-PRE-COMPILE, post-build-variant-used=false
    General (PduRGeneral): PduRDevErrorDetect=false, PduRMetaDataSupport=false, PduRVersionInfoApi=false, PduRZeroCostOperation=false
    Routes (PduRRoutingPaths): PduRConfigurationId=0
      RxValueSource (PduRSrcPdu): PduRSourcePduHandleId=0, PduRSrcPduUpTxConf=true, PduRSrcPduRef=Pdus/RxValuePdu
      RxValueDestination (PduRDestPdu): PduRDestPduHandleId=0, PduRTransmissionConfirmation=true, PduRDestPduRef=Pdus/RxValuePdu
      RxValue (PduRRoutingPath): PduRSrcPduRRef=RxValueSource, PduRDestPduRRef=RxValueDestination
      TxValueSource (PduRSrcPdu): PduRSourcePduHandleId=1, PduRSrcPduUpTxConf=true, PduRSrcPduRef=Pdus/TxValuePdu
      TxValueDestination (PduRDestPdu): PduRDestPduHandleId=1, PduRTransmissionConfirmation=true, PduRDestPduRef=Pdus/TxValuePdu
      TxValue (PduRRoutingPath): PduRSrcPduRRef=TxValueSource, PduRDestPduRRef=TxValueDestination
      DiagRequestSource (PduRSrcPdu): PduRSourcePduHandleId=2, PduRSrcPduUpTxConf=true, PduRSrcPduRef=DiagRequestSdu
      DiagRequestDestination (PduRDestPdu): PduRDestPduHandleId=2, PduRTransmissionConfirmation=true, PduRDestPduRef=DiagRequestSdu
      DiagRequest (PduRRoutingPath): PduRSrcPduRRef=DiagRequestSource, PduRDestPduRRef=DiagRequestDestination
      DiagResponseSource (PduRSrcPdu): PduRSourcePduHandleId=3, PduRSrcPduUpTxConf=true, PduRSrcPduRef=DiagResponseSdu
      DiagResponseDestination (PduRDestPdu): PduRDestPduHandleId=3, PduRTransmissionConfirmation=true, PduRDestPduRef=DiagResponseSdu
      DiagResponse (PduRRoutingPath): PduRSrcPduRRef=DiagResponseSource, PduRDestPduRRef=DiagResponseDestination
