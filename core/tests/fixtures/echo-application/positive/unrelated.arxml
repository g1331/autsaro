AUTOSAR XML (schema 00053)
package /Unrelated
  base type UnrelatedUint16: category=FIXED_LENGTH, base-type-size=16, base-type-encoding=NONE, native-declaration=uint16
