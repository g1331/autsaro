AUTOSAR XML (schema 00053)
package /Services
  service sw component type DcmService
    require port ApplicationValue: client-com-spec=ReadData, required-interface=DataServices_ApplicationValue
    behavior Behavior
      runnable DcmReadData: symbol=DcmService_ReadData
        sync call ReadApplicationValue: operation=ApplicationValue.ReadData
